## CMakeLists.txt
```
#
# Copyright (c) 2020 Nordic Semiconductor
#
# SPDX-License-Identifier: LicenseRef-5-Clause-Nordic
#
cmake_minimum_required(VERSION 3.20.0)

if (EXISTS "${CMAKE_CURRENT_SOURCE_DIR}/mcuboot.conf")
    list(APPEND mcuboot_OVERLAY_CONFIG
      "${CMAKE_CURRENT_SOURCE_DIR}/mcuboot.conf"
      )
endif()

find_package(Zephyr REQUIRED HINTS $ENV{ZEPHYR_BASE})

project(n91_dfu)

zephyr_include_directories(src)
zephyr_include_directories(libs/simp)
zephyr_include_directories(libs/flash)
zephyr_include_directories(libs/dfu_module)

target_sources(app PRIVATE src/main.c)

#Library adds
target_sources(app PRIVATE libs/dfu_module/http_client.c)
target_sources(app PRIVATE libs/dfu_module/int_dfu_helper.c)
target_sources(app PRIVATE libs/dfu_module/dfu_modul.c)

target_sources(app PRIVATE libs/simp/uart_drv.c)
target_sources(app PRIVATE libs/simp/simp.c)

target_sources(app PRIVATE libs/flash/app_flash.c)
```

## prj.conf
```kconfig
### Enable debug optimization
#CONFIG_NO_OPTIMIZATIONS=y         # This option will make NBIOT **CRASH**
CONFIG_DEBUG_OPTIMIZATIONS=y

# Logging
CONFIG_LOG=y
CONFIG_LOG_MODE_IMMEDIATE=y

# NEWLIB C
CONFIG_NEWLIB_LIBC=y
CONFIG_NEWLIB_LIBC_FLOAT_PRINTF=y

### Enable LOG, LOG_MINIMAL and ASSERT
CONFIG_NCS_SAMPLES_DEFAULTS=y

### Enable LOG prefix
# CONFIG_LOG_MINIMAL=n

### Enable reboot
CONFIG_REBOOT=y # Enable sys_reboot()

### Disable printing boot banner
CONFIG_BOOT_BANNER=n

### Enable k_malloc/k_free
CONFIG_HEAP_MEM_POOL_SIZE=2048
CONFIG_MAIN_STACK_SIZE=8192

### Enabel Flash library
CONFIG_FLASH=y
CONFIG_IMG_MANAGER=y
CONFIG_IMG_ERASE_PROGRESSIVELY=y
CONFIG_MPU_ALLOW_FLASH_WRITE=y		# Necessary for flash map write/erase operation

### Peripheral-GPIO
CONFIG_GPIO=y

### Peripheral-UART
# Async
# https://devzone.nordicsemi.com/f/nordic-q-a/72651/nrf9160-uart-loosing-data-when-rxdata-is-split-into-2-buffers-async-api
# Hardware RX byte counting
CONFIG_SERIAL=y
CONFIG_UART_ASYNC_API=y
CONFIG_NRFX_UARTE=y
CONFIG_NRFX_UARTE1=y
CONFIG_NRFX_TIMER2=y
CONFIG_UART_1_NRF_HW_ASYNC=y
CONFIG_UART_1_NRF_HW_ASYNC_TIMER=1

### Network
CONFIG_NETWORKING=y
CONFIG_NET_SOCKETS=y
CONFIG_NET_NATIVE=n

### LTE
CONFIG_LTE_LINK_CONTROL=y
CONFIG_LTE_AUTO_INIT_AND_CONNECT=n

#SMS
CONFIG_SMS=y
CONFIG_SMS_SUBSCRIBERS_MAX_CNT=1
CONFIG_SMS_LOG_LEVEL_DBG=n

### Download client
CONFIG_DOWNLOAD_CLIENT=y
CONFIG_DOWNLOAD_CLIENT_STACK_SIZE=4096

### MCUBoot and DFU
CONFIG_BOOTLOADER_MCUBOOT=y
CONFIG_DFU_TARGET=y
CONFIG_FOTA_DOWNLOAD=y

#Modem Stuff
CONFIG_MODEM_INFO=y
CONFIG_NRF_MODEM_LIB=y
CONFIG_DATE_TIME=y

# Device power management
CONFIG_PM_DEVICE=y

# Library for buttons and LEDs
CONFIG_DK_LIBRARY=y
CONFIG_DK_LIBRARY_INVERT_LEDS=n

#Logging
CONFIG_CONSOLE=y
CONFIG_UART_CONSOLE=n
CONFIG_RTT_CONSOLE=y
CONFIG_USE_SEGGER_RTT=y
```

## mcuboot.conf
```kconfig
CONFIG_BOOT_SIGNATURE_KEY_FILE="C:/apoplexmed/keys/key_ecdsap256.pem"
```

## nrf9160dk_nrf9160_ns.overlay
```dts
// To get started, press Ctrl+Space to bring up the completion menu and view the available nodes.
// For more help, browse the DeviceTree documentation at https://docs.zephyrproject.org/latest/guides/dts/index.html
&uart1 {
	status = "okay";
	current-speed = < 230400 >;
	label = "UART_1";
	rx-pin = <10>;
	tx-pin = <11>; 
	rx-pull-up;
};
&gpio0{
	gpio-controller;
	wakeup-source;
	label = "GPIO_0";
};

&gpiote {
	interrupts = <49 NRF_DEFAULT_IRQ_PRIORITY>;
};
```

## src/main.c
```c
#include <string.h>
#include <kernel.h>
#include <zephyr.h>
#include <net/fota_download.h>
#include <sys/reboot.h>
#include <sys/byteorder.h>
#include <dfu/dfu_target.h>
#include <dfu/mcuboot.h>
#include <modem/modem_info.h>
#include <nrf_modem.h>
#include <posix/time.h>
#include <sys/timeutil.h>
#include <date_time.h>
#include <modem/sms.h>

#include <dk_buttons_and_leds.h>
#include <logging/log.h>

LOG_MODULE_REGISTER(main, 3);


#include "app_flash.h"

//Necessary simp Module
#include "simp.h"

//Dfu Module
#include "http_client.h"
#include "int_dfu_helper.h"
#include "dfu_modul.h"

// Auf true setzen um Update Image zuerzeugen. NICHT FLASHEN !
#define UPDATE_APP 					false

//CMDS After 0xC0 - 0XFF for Application use

#define CMD_OP_GO_TO_SLEEP			0xC0

struct k_timer 		update_timer; //Cant be Declared static

static struct k_work helper;
static struct k_work sleep;

//Todo Clean up and move to dfu_module.h
static void sms_callback(struct sms_data *const data, void *context)
{
	if (data == NULL) {
		LOG_INF("%s with NULL data\n", __func__);
		return;
	}
	if (data->type == SMS_TYPE_DELIVER) {
		/* When SMS message is received, print information */
		struct sms_deliver_header *header = &data->header.deliver;

		LOG_INF("SMS received:");
		LOG_INF("Time:   %02d-%02d-%02d %02d:%02d:%02d",
			header->time.year,
			header->time.month,
			header->time.day,
			header->time.hour,
			header->time.minute,
			header->time.second);

		LOG_INF("Text:   '%s'", data->payload);
		parse_sms(data->payload,data->payload_len);

	} else {
		LOG_INF("SMS protocol message with unknown type received");
	}
}

static int req_sleep(uint8_t* p_req, uint16_t req_len, cmd_respond_t respond)
{
	int err = 0;
	LOG_INF("Request to go Sleepy Time");

	k_work_submit(&sleep);

	respond(NULL,0);

	return err;
}


/** @brief CB Function for DK Buttons*/
void button_handler(uint32_t button_state, uint32_t has_changed)
{
	if(DK_BTN1_MSK & button_state){
		//Entry Point Manual Update.
		//Alternate Entry via Timer or SMS Notification
		dk_set_led(DK_LED2,0);
		k_work_submit(&helper);
	}
}

//Sends Chip to Sleep
void try_to_sleep(struct k_work* unused){
	//Disable SMS Receiver and Timer
	disable_dfu_module();

	//Disable SIMP Module
	app_cmd_disable();

	//Send to Sleep via Zephyr Command
	//pm_system_suspend(); //Todo Add Wakeup Source
}

void main(void)
{
	int err = 0;

#if UPDATE_APP
	LOG_INF("Cross DFU Demo(new)\n");
#else 
	LOG_INF("Cross DFU Demo(ori)\n");
#endif

	err = dk_leds_init();
	if (err) {
		LOG_ERR("Cannot init LEDs (err: %d)", err);
	}

#if UPDATE_APP
	dk_set_led(DK_LED4,1);
#else
	dk_set_led(DK_LED3,1);
#endif

	LOG_INF("switch left:  single-/-double download");
	LOG_INF("switch right: 91-/-52\n");

	err = dk_buttons_init(button_handler);
	if (err) {
		LOG_ERR("Cant init LED Component");
	}

	const struct device* m_uart_dev = device_get_binding("UART_1");
	if (m_uart_dev == NULL) {
		LOG_ERR("Can't init UART component");
		return;
	}
	//Initialize Uart before dfu_module
	app_cmd_init(m_uart_dev);
	app_cmd_event_cb_register(app_cmd_event_handler);

	app_cmd_add(CMD_OP_GO_TO_SLEEP,req_sleep,NULL);

	initalize_dfu_module();

	// After LTE connection, LED 1 is on
	dk_set_led(DK_LED1,1);	
	
	//Yes double init i dont know why you have to do that but only then it works
	err = sms_register_listener(sms_callback, NULL);
	if (err) {
		LOG_INF("sms_register_listener returned err: %d", err);
		return;
	}

	sms_unregister_listener(0);

	k_work_init(&helper,askserver);
	k_work_init(&sleep,try_to_sleep);

	err = sms_register_listener(sms_callback, NULL);
	if (err) {
		LOG_INF("sms_register_listener returned err: %d", err);
		return;
	}
	//Enables GPIO As Wake Up Source
	//pm_device_wakeup_enable();
	//Todo enable GPIO

	/* All initializations were successful mark image as working so that we
	 * will not revert upon reboot.
	 */
	boot_write_img_confirmed();
 
	//Start Timer if you want to test it
	//k_timer_start(&update_timer, K_SECONDS(3), K_SECONDS(3));
	//1440 Minutes -> 24 Hours use K_MINUTES()
	//get_device_status();
	LOG_INF("All Initialized Starting Idle Loop");
	while (true) {
		k_sleep(K_SECONDS(10));
	}
}

void timer_expiry(struct k_timer *timer_id){
	LOG_INF("In Timer Expiry Function");
	k_work_submit(&helper);
}

K_TIMER_DEFINE(update_timer, timer_expiry, NULL);
```

## src/app_cmd.c
```c
#include <string.h>
#include <zephyr.h>
#include <device.h>
#include <sys/byteorder.h>
#include <sys/crc.h>
#include <logging/log.h>
LOG_MODULE_REGISTER(cmd, 4);

#include "app_cmd.h"
#include "app_uart.h"

#define SKIP_CRC_CHECK                  false            /* Switch option to skip CRC check or not */

#define CMD_PACKET_LENGTH               1040
#define CMD_POOL_DEPTH                  2
#define CMD_CB_LIST_LEN                 20

#define crc16_compute(p_data, len)      crc16_itu_t(0x0, p_data, len)
#define uint16_decode(p_data)           sys_get_le16(p_data)
#define uint16_encode(value, p_data)    sys_put_le16(value, p_data)

/* Time between requset sent to response received is:
 * slave process request, slave send response data.
 * Host must set a long enough time to wait it, and
 * there should be a timer refresh feature, to avoid
 * timeout is triggered during UART is in active.
 *
 * Note, this value can't be small, some activities such 
 * as flash erase will cost several seconds
 */
#define WAIT_RSP_TIMEOUT                K_MSEC(10000)

 /* string names of each cmd state */
const static char* cmd_state_str[] = {
    "idle", "req_sending", "req_sent",
    "req_receiving", "req_received",
    "rsp_sending", "rsp_sent",
    "rsp_receiving", "rsp_received",
    "err_timeout", "err_sending",
    "err_receiving",
};

const static char* cmd_mode_str[] = {
    "idle", "host", "slave"
};

typedef struct
{
    uint8_t*   p_data;                 /* Pointer of data */
    uint16_t   length;                 /* Data length of the buffer */
    uint16_t   offset;                 /* Datat offset of the buffer */
} buffer_t;

static uint8_t          m_rx_pool[CMD_PACKET_LENGTH];
static uint8_t          m_tx_pool[CMD_PACKET_LENGTH];

static cmd_context_t    m_cmd_ctx;

static buffer_t         m_rx_buff;
static buffer_t         m_tx_buff;

static cmd_event_cb_t   m_event_cb;

static struct k_work    wk_proc_req;               /* A k_work to process request */
static struct k_work    wk_proc_rsp;               /* A k_work to process response */

static cmd_cb_t m_cb_list[CMD_CB_LIST_LEN];    /* User cmd list */

/* Function declaration */
static int req_cb_ping(uint8_t* p_req, uint16_t req_len, cmd_respond_t respond);
static void rsp_cb_ping(uint8_t* p_rsp, uint16_t rsp_len);
static void rsp_cb_raw_data(uint8_t* p_rsp, uint16_t rsp_len);
static int req_cb_raw_data(uint8_t* p_req, uint16_t req_len, cmd_respond_t respond);
static void state_handler(cmd_context_t* p_cmd_ctx);
static int buff_to_cmd(buffer_t* p_buff, app_cmd_t* p_cmd);
static int app_cmd_respond(uint8_t* p_data, uint16_t length);
static void tmr_rsp_timeout_handler(struct k_timer* timer);

/* Timer for waiting response */
K_TIMER_DEFINE(tmr_wait_rsp, tmr_rsp_timeout_handler, NULL);


/**@brief Dummy function of cmd event callback */
static void event_cb_dummy(cmd_event_t* p_event) {;}

/**@brief Check the crc of data sequence with a target crc
 *
 * @param[in] p_data: pointer of the data
 * @param[in] length: data length
 * @param[in] crc_target: target crc
 *
 * @return true: crc matches
 *         false: crc doesn't match
 */
static bool crc16_check(uint8_t* p_data, uint16_t length, uint16_t crc_target)
{
#ifdef SKIP_CRC_CHECK
    if (SKIP_CRC_CHECK) {
        return true;
    }
#endif

    return crc16_compute(p_data, length) == crc_target;
}

/**@brief Allocate a buffer from the pool
 *
 * @note There may be better solution
 *
 * @param[in] p_pool: pointer of data pool
 * @param[in] p_buff: pointer of buffer
 */
static void buff_alloc(uint8_t* p_pool, buffer_t* p_buff)
{
    __ASSERT_NO_MSG(p_pool != NULL);
    __ASSERT_NO_MSG(p_buff != NULL);

    p_buff->p_data = p_pool;
    p_buff->length = 0;
    p_buff->offset = 0;
}

/**@brief Set cmd state */
static void state_set(cmd_context_t* p_cmd_ctx, cmd_state_t new_state)
{
    cmd_state_t old_state = p_cmd_ctx->state;

    if (old_state != new_state) {
        p_cmd_ctx->state = new_state;

        // Always don't enable this print because it may cause 
        // UART data loss when receiving
        //LOG_DBG("State: %s -> %s",      \
            cmd_state_str[old_state],   \
            cmd_state_str[new_state]);

        state_handler(p_cmd_ctx);
    }
}

/**@brief Set a new cmd mode */
static void mode_set(cmd_context_t* p_cmd_ctx, cmd_mode_t new_mode)
{
    cmd_mode_t old_mode = p_cmd_ctx->mode;
    if (old_mode != new_mode) {
        p_cmd_ctx->mode = new_mode;

        // Always don't enable this print because it may cause 
        // UART data loss when receiving
        //LOG_DBG("Mode: %s -> %s", \
            cmd_mode_str[old_mode], \
            cmd_mode_str[new_mode]);
    }
}

/**@brief Get current cmd mode */
static cmd_mode_t mode_get(cmd_context_t* p_cmd_ctx)
{
    return p_cmd_ctx->mode;
}

/**@brief Get current cmd state */
static cmd_state_t state_get(cmd_context_t* p_cmd_ctx)
{
    return p_cmd_ctx->state;
}

/**@brief State change handler */
static void state_handler(cmd_context_t* p_cmd_ctx)
{
    cmd_state_t state = p_cmd_ctx->state;

    switch (state) {

    case CMD_STATE_IDLE:
        app_uart_rx_reset();
        mode_set(p_cmd_ctx, CMD_MODE_IDLE);
        LOG_DBG("-------------");
        break;

    case CMD_STATE_REQ_SENDING:
        mode_set(p_cmd_ctx, CMD_MODE_HOST);
        break;

    case CMD_STATE_REQ_SENT:
        /* Issue an one shot timer */
        k_timer_start(&tmr_wait_rsp, WAIT_RSP_TIMEOUT, K_NO_WAIT);
        break;

    case CMD_STATE_RSP_RECEIVING:
        /* TODO: Refresh timer count, to avoid
         * timeout during UART receiving. Now I 
         * set a very long timeout value so it's 
         * safe. */
        break;

    case CMD_STATE_RSP_RECEIVED:
        k_timer_stop(&tmr_wait_rsp);
        k_work_submit(&wk_proc_rsp);
        break;

    case CMD_STATE_REQ_RECEIVING:
        mode_set(p_cmd_ctx, CMD_MODE_SLAVE);
        break;

    case CMD_STATE_REQ_RECEIVED:
        k_work_submit(&wk_proc_req);
        break;

    case CMD_STATE_ERR_TIMEOUT:
        state_set(p_cmd_ctx, CMD_STATE_IDLE);
        break;

    case CMD_STATE_ERR_RECEIVE:
        if (mode_get(&m_cmd_ctx) != CMD_MODE_HOST) {
            state_set(p_cmd_ctx, CMD_STATE_IDLE);
        }
        break;

    case CMD_STATE_RSP_SENT:
    case CMD_STATE_ERR_SEND:
        state_set(p_cmd_ctx, CMD_STATE_IDLE);
        break;

    case CMD_STATE_RSP_SENDING:
    default:
        /* Do nothing */
        break;
    }
}

/**@brief Handler for sending cmd start */
static void on_cmd_send_start(void)
{
    LOG_DBG("%s", __func__);

    if (mode_get(&m_cmd_ctx) == CMD_MODE_SLAVE) {
        state_set(&m_cmd_ctx, CMD_STATE_RSP_SENDING);
    }
    else {
        state_set(&m_cmd_ctx, CMD_STATE_REQ_SENDING);
    }
}

/**@brief Handler for sending cmd complete */
static void on_cmd_send_complete(void)
{
    LOG_DBG("%s", __func__);

    if (mode_get(&m_cmd_ctx) == CMD_MODE_HOST) {
        state_set(&m_cmd_ctx, CMD_STATE_REQ_SENT);
    }
    else if (mode_get(&m_cmd_ctx) == CMD_MODE_SLAVE) {
        state_set(&m_cmd_ctx, CMD_STATE_RSP_SENT);
    }
    else {
        LOG_ERR("Should not come here");
    }
}

/**@brief Handler for sending cmd error */
static void on_cmd_send_error(void)
{
    LOG_ERR("%s", __func__);

    state_set(&m_cmd_ctx, CMD_STATE_ERR_SEND);
}

/**@brief Handler for receiving cmd start */
static void on_cmd_receive_start(void)
{
    LOG_DBG("%s", __func__);

    if (mode_get(&m_cmd_ctx) == CMD_MODE_HOST) {
        state_set(&m_cmd_ctx, CMD_STATE_RSP_RECEIVING);
    }
    else {
        state_set(&m_cmd_ctx, CMD_STATE_REQ_RECEIVING);
    }
}

/**@brief Handler for receiving cmd complete */
static void on_cmd_receive_complete(void)
{
    LOG_DBG("%s", __func__);

    if (mode_get(&m_cmd_ctx) == CMD_MODE_HOST) {
        state_set(&m_cmd_ctx, CMD_STATE_RSP_RECEIVED);
    }
    else if (mode_get(&m_cmd_ctx) == CMD_MODE_SLAVE) {
        state_set(&m_cmd_ctx, CMD_STATE_REQ_RECEIVED);
    }
    else {
        LOG_WRN("Should not come here");
    }
}

/**@brief Handler for receiving cmd error */
static void on_cmd_receive_error(void)
{
    LOG_ERR("%s", __func__);

    state_set(&m_cmd_ctx, CMD_STATE_ERR_RECEIVE);
}

/**@brief Get element count of cmd list */
int cmd_cb_cnt(void)
{
    for (int i = 0; i < CMD_CB_LIST_LEN; i++) {
        if (m_cb_list[i].op_code == 0) {
            return i;
        }
    }

    return CMD_CB_LIST_LEN;
}

/**@brief Get element of cmd list by op code 
 *
 * @param[in] op_code: op code of cmd
 * @param[out] p_cmd_cb: pointer of cmd callback, it can be NULL
 *
 * @return -1: not found
 *         others(>=0): index of the cmd callback
 */
static int cmd_cb_get(uint8_t op_code, cmd_cb_t* p_cmd_cb)
{
    int rc;
    int count;

    rc = -1;
    count = cmd_cb_cnt();

    for (int i = 0; i < count; i++) {
        if (m_cb_list[i].op_code == op_code) {
            if (p_cmd_cb != NULL) {
                p_cmd_cb->proc_req = m_cb_list[i].proc_req;
                p_cmd_cb->proc_rsp = m_cb_list[i].proc_rsp;
            }

            rc = 0;
            break;
        }
    }

    return rc;
}

/**@brief Add a cmd to the list
 *
 * @param[in] op_code: op code of cmd
 * @param[in] req_cb: request callback function
 * @param[in] rsp_cb: response callback function
 *
 * @return 0: success
 * @return -1: cmd list is full
 * @return -2: op code is existed
 */
int app_cmd_add(uint8_t op_code, req_cb_t req_cb, rsp_cb_t rsp_cb)
{
    cmd_cb_t callback;
    int count;

    count = cmd_cb_cnt();
    if (count == CMD_CB_LIST_LEN) {
        LOG_ERR("Cmd list is full");
        return -1;
    }

    if (cmd_cb_get(op_code, NULL) == 0) {
        LOG_WRN("This op code is existed %x",op_code);
        return -2;
    }

    memset(&callback, 0, sizeof(cmd_cb_t));
    callback.op_code = op_code;
    callback.proc_req = req_cb;
    callback.proc_rsp = rsp_cb;

    memcpy(&m_cb_list[count], &callback, sizeof(cmd_cb_t));

    return 0;
}

/**@brief Handler for waiting response timeout */
static void tmr_rsp_timeout_handler(struct k_timer* timer)
{
    LOG_DBG("%s", __func__);

    uint32_t  err_code;
    app_cmd_t cmd;
    cmd_cb_t  cmd_cb;
    cmd_event_t event;

    err_code = buff_to_cmd(&m_tx_buff, &cmd);
    if (err_code != 0) {
        LOG_ERR("Buffer error");
        return;
    }

    err_code = cmd_cb_get(cmd.op_code, &cmd_cb);
    if (err_code == 0) {
        uint8_t p_rsp[] = CMD_RSP_TIMEOUT;

        if (cmd_cb.proc_rsp) {
            cmd_cb.proc_rsp(p_rsp, sizeof(p_rsp));
        }

        event.op_code = cmd.op_code;
        event.p_data = p_rsp;
        event.length = sizeof(p_rsp);
        event.timeout = true;

        m_event_cb(&event);
    }
    else {
        // Should not come here
        LOG_ERR("op is unregisterd(wait rsp)");
    }

    state_set(&m_cmd_ctx, CMD_STATE_IDLE);
}

/**@brief Handler for processing request */
static void wk_proc_req_handler(struct k_work* unused)
{
    LOG_DBG("%s", __func__);

    int err_code;
    app_cmd_t cmd;
    cmd_cb_t  cmd_cb;
    cmd_event_t event;

    err_code = buff_to_cmd(&m_rx_buff, &cmd);
    if (err_code != 0) {
        LOG_ERR("Buffer error");
        return;
    }

    err_code = cmd_cb_get(cmd.op_code, &cmd_cb);
    if (err_code == 0) {
        if (cmd_cb.proc_req) {
            cmd_cb.proc_req(cmd.p_data, cmd.length, app_cmd_respond);
        }
        else {
            app_cmd_respond(NULL, 0);
        }

        event.op_code = cmd.op_code;
        event.p_data = cmd.p_data;
        event.length = cmd.length;
        event.timeout = false;

        m_event_cb(&event);
    }
    else {
        LOG_ERR("op is unregisterd(proc req)");
        uint8_t p_rsp[] = CMD_RSP_UNREG;

        app_cmd_respond(p_rsp, sizeof(p_rsp));
    }
}

/**@brief Handler for processing response */
static void wk_proc_rsp_handler(struct k_work* unused)
{
    LOG_DBG("%s", __func__);

    int err_code;
    app_cmd_t cmd;
    cmd_cb_t  cmd_cb;
    cmd_event_t event;

    state_set(&m_cmd_ctx, CMD_STATE_IDLE);

    err_code = buff_to_cmd(&m_rx_buff, &cmd);
    if (err_code != 0) {
        LOG_ERR("Buffer error");
        return;
    }

    err_code = cmd_cb_get(cmd.op_code, &cmd_cb);
    if (err_code == 0) {
        if (cmd_cb.proc_rsp) {
            cmd_cb.proc_rsp(cmd.p_data, cmd.length);
        }

        event.op_code = cmd.op_code;
        event.p_data = cmd.p_data;
        event.length = cmd.length;
        event.timeout = false;

        m_event_cb(&event);
    }
    else {
        // Should not come here
        LOG_ERR("op is unregisterd(proc rsp): %d", cmd.op_code);
    }
}

/**@brief Get cmd length from cmd data buffer
 *
 * @param[in] p_buff: pointer of cmd data buffer
 *
 * @return 0: not found
 *         others: cmd length
 */
static uint16_t cmd_len_get(buffer_t* p_buff)
{
    uint8_t* p_data;
    uint16_t cmd_len;
    uint16_t len;

    cmd_len = 0;
    p_data = p_buff->p_data;

    if (p_buff->length > CMD_FMT_SIZE_START + CMD_FMT_SIZE_LEN) {
        len = uint16_decode(&p_data[CMD_FMT_OFFSET_LEN]);
        LOG_DBG("%02x",len);
        cmd_len = CMD_FMT_OFFSET_OPCODE + CMD_FMT_SIZE_CRC + len;
    }

    return cmd_len;
}

/**@brief Validate format of a cmd
 *
 * @param[in] p_buff: pointer of cmd data buffer
 * @param[in] op_code: op code of the request in host mode,
 *  in slave mode, it's not used
 *
 * @return 0: format is ok
 *         -1: format is wrong
 */
static int format_check(buffer_t* p_buff, uint8_t op_code, cmd_mode_t mode)
{
    uint16_t cmd_len;
    uint16_t cmd_crc;
    bool crc_ok;

    uint8_t* p_data = p_buff->p_data;
    uint16_t length = p_buff->length;

    // Check start flag
    if (mode == CMD_MODE_HOST &&
        p_data[CMD_FMT_OFFSET_START] != CMD_FMT_START_RSP) {
        LOG_ERR("Invalid cmd format: start(host)");
        return -1;
    }
    else if (mode == CMD_MODE_SLAVE &&
        p_data[CMD_FMT_OFFSET_START] != CMD_FMT_START_REQ) {
        LOG_ERR("Invalid cmd format: start(slave)");
        return -1;
    }

    // Check length
    cmd_len = uint16_decode(&p_data[CMD_FMT_OFFSET_LEN]) +
        CMD_FMT_OFFSET_OPCODE + CMD_FMT_SIZE_CRC;
    if (length != cmd_len) {
        LOG_ERR("Invalid cmd format: length");
        return -1;
    }

    // Check op code
    if (mode == CMD_MODE_HOST &&
        p_data[CMD_FMT_OFFSET_OPCODE] != op_code) {
        LOG_ERR("Invalid cmd format: op code");
        return -1;
    }

    // Check CRC
    cmd_crc = uint16_decode(&p_data[cmd_len - CMD_FMT_SIZE_CRC]);
    crc_ok = crc16_check(&p_data[CMD_FMT_OFFSET_LEN],
        cmd_len - CMD_FMT_SIZE_START - CMD_FMT_SIZE_CRC,
        cmd_crc);
    if (!crc_ok) {
        LOG_ERR("Invalid cmd format: crc");
        return -1;
    }

    return 0;
}
/**@brief Get op code from a cmd data buffer */
static int op_code_get(buffer_t* p_buff, uint8_t* op_code)
{
    if (p_buff == NULL || p_buff->p_data == NULL) {
        return -1;
    }

    // Assume it's a valid buffer, so skip format check
    *op_code = p_buff->p_data[CMD_FMT_OFFSET_OPCODE];

    return 0;
}

/**@brief Build a data buffer from a cmd structure
 *
 * @note It will allocate memory for buffer
 *
 * @param[in] p_cmd: pointer of cmd
 * @param[out] p_buff: cmd data buffer
 *
 * @return 0: ok
 */
static int cmd_to_buff(app_cmd_t* p_cmd, buffer_t* p_buff)
{
    __ASSERT_NO_MSG(p_cmd != NULL);

    uint16_t crc16;
    uint16_t pdu_len;
    uint8_t* p_packet;
    uint16_t pkt_len;

    buff_alloc(m_tx_pool, p_buff);

    p_packet = p_buff->p_data;
    pdu_len = p_cmd->length;

    /* Start flag */
    p_packet[CMD_FMT_OFFSET_START] =
        (p_cmd->type == CMD_TYPE_RESPONSE) ?
        CMD_FMT_START_RSP :
        CMD_FMT_START_REQ;

    /* Length */
    uint16_encode(CMD_FMT_SIZE_OPCODE + pdu_len,
        &p_packet[CMD_FMT_OFFSET_LEN]);

    /* OP code */
    p_packet[CMD_FMT_OFFSET_OPCODE] = p_cmd->op_code;

    /* PDU */
    if (pdu_len > 0 && p_cmd->p_data != NULL) {
        memcpy(&p_packet[CMD_FMT_OFFSET_PDU], p_cmd->p_data, pdu_len);
    }

    /* CRC: crc16 init value must be 0 */
    crc16 = crc16_compute(&p_packet[CMD_FMT_OFFSET_LEN],
        CMD_FMT_SIZE_LEN + CMD_FMT_SIZE_OPCODE + pdu_len);
    uint16_encode(crc16, &p_packet[CMD_FMT_OFFSET_PDU + pdu_len]);

    /* Packet length */
    pkt_len = CMD_FMT_OFFSET_PDU + pdu_len + CMD_FMT_SIZE_CRC;
    pkt_len = MIN(pkt_len, CMD_PACKET_LENGTH);

    p_buff->length = pkt_len;

    return 0;
}

/**@brief Get a cmd from a data buff 
 * 
 * @param[in] p_buff: cmd data buffer
 * @param[out] p_cmd: pointer of cmd
 *
 * @return 0: ok
 *         -1: pointer is NULL
 */
static int buff_to_cmd(buffer_t* p_buff, app_cmd_t* p_cmd)
{
    if (p_buff->p_data == NULL || p_cmd == NULL) {
        return -1;
    }

    uint8_t* p_data;
    uint16_t op_pdu_len;

    p_data = p_buff->p_data;
    op_pdu_len = uint16_decode(&p_data[CMD_FMT_OFFSET_LEN]);

    p_cmd->type = p_data[CMD_FMT_OFFSET_START];
    p_cmd->op_code = p_data[CMD_FMT_OFFSET_OPCODE];
    p_cmd->length = op_pdu_len - CMD_FMT_SIZE_OPCODE;
    p_cmd->p_data = &p_data[CMD_FMT_OFFSET_PDU];

    return 0;
}

/**@brief Send a cmd by UART */
static int cmd_send(app_cmd_t* p_cmd)
{
    on_cmd_send_start();

    cmd_to_buff(p_cmd, &m_tx_buff);
    return app_uart_send(m_tx_buff.p_data, m_tx_buff.length);
}

/**@brief Send a response */
static int app_cmd_respond(uint8_t* p_data, uint16_t length)
{
    int err_code;
    uint8_t  op_code;
    app_cmd_t cmd;

    if (state_get(&m_cmd_ctx) != CMD_STATE_REQ_RECEIVED &&
        state_get(&m_cmd_ctx) != CMD_STATE_REQ_SENT) {
        LOG_ERR("Invalid state for response:%d", state_get(&m_cmd_ctx));
        return -1;
    }

    err_code = op_code_get(&m_rx_buff, &op_code);
    if (err_code != 0) {
        LOG_ERR("rx buffer is reset too early");
        on_cmd_send_error();
        return err_code;
    }

    cmd.type = CMD_TYPE_RESPONSE;
    cmd.op_code = op_code;
    cmd.p_data = p_data;
    cmd.length = length;

    return cmd_send(&cmd);
}

/**@brief Send a request cmd
 *
 * @param[in] op_code: cmd op code
 * @param[in] p_data: pointer of cmd data
 * @param[in] length: length of cmd data
 *
 * @return 0: success
 * @return -1: error
 */
uint32_t app_cmd_request(uint8_t op_code, uint8_t* p_data, uint16_t length)
{
    if (mode_get(&m_cmd_ctx) != CMD_MODE_IDLE) {
        LOG_ERR("%s, exit with %d", __func__, m_cmd_ctx.mode);
        return -1;
    }

    app_cmd_t cmd =
    {
        .type = CMD_TYPE_REQUEST,
        .op_code = op_code,
        .p_data = p_data,
        .length = length,
    };

    mode_set(&m_cmd_ctx, CMD_MODE_HOST);

    return cmd_send(&cmd);
}

/**@brief Register a callback for request and response
 *
 * @note This functions is duplicated to callback functions
 * (req_proc, rsp_proc), but it's useful 
 *
 * @todo Check to remove rsp_proc
 */
void app_cmd_event_cb_register(cmd_event_cb_t event_cb)
{
    if (event_cb != NULL) {
        m_event_cb = event_cb;
    }
}

/**@brief Handler for UART tx complete */
static void on_uart_tx_empty(int event)
{
    LOG_DBG("%s", __func__);
    if (event == 0) {
        on_cmd_send_complete();
    }
    else {
        on_cmd_send_error();
    }
}

/**@brief Handler for UART rx data ready */
static void on_uart_rx_ready(uint8_t* p_data, uint16_t length)
{
    int err_code;
    uint8_t  req_op_code;
    static bool rx_started; //false init
    static uint16_t cmd_len;
    //LOG_WRN("%s, length=%d", __func__, length);

    if (mode_get(&m_cmd_ctx) == CMD_MODE_HOST) {
        if (m_cmd_ctx.state != CMD_STATE_REQ_SENT &&
            m_cmd_ctx.state != CMD_STATE_RSP_RECEIVING) {
            LOG_WRN("Invalid state for rx(host)");
            return;
        }
    }

    if (mode_get(&m_cmd_ctx) == CMD_MODE_SLAVE) {
        if (m_cmd_ctx.state != CMD_STATE_REQ_RECEIVING) {
            LOG_WRN("Invalid state for rx(slave)");
            return;
        }
    }

    LOG_INF("Length Rec: %hd",length);
    
    if (!rx_started) {
        rx_started = true;
        buff_alloc(m_rx_pool, &m_rx_buff);
        memcpy(m_rx_buff.p_data, p_data, length);
        m_rx_buff.length = length;
        cmd_len = 0;
        on_cmd_receive_start();
    }else{
        m_rx_buff.length += length;
    }

    //m_rx_buff.length = length;

    if (cmd_len == 0) {

        cmd_len = cmd_len_get(&m_rx_buff);

        if (cmd_len > CMD_PACKET_LENGTH) {
            LOG_ERR("CMD_Len Larger than Packet Length %d",cmd_len);
            on_cmd_receive_error();
        }

        if (cmd_len == 0) {
            return;
        }
    }

    if (m_rx_buff.length < cmd_len) {
        return;
    }

    LOG_HEXDUMP_DBG(m_rx_buff.p_data, m_rx_buff.length, "RX");

    req_op_code = 0;
    if (mode_get(&m_cmd_ctx) == CMD_MODE_HOST) {
        op_code_get(&m_tx_buff, &req_op_code);
    }
    err_code = format_check(&m_rx_buff, req_op_code, mode_get(&m_cmd_ctx));

    if (err_code == 0) {
        on_cmd_receive_complete();
    }
    // Invalid format
    else if (err_code == -1) {
        LOG_ERR("Command has Invald Format");
        on_cmd_receive_error();
    }
    // On going receiving
    else {
        LOG_ERR("Should not come here(%d)", err_code);
        on_cmd_receive_error();
    }

    rx_started = false;
}

/**@brief Initialize app cmd module
 *
 * @param[in] p_device: pointer of UART device
 * @param[in] evt_cb: callback of cmd event
 *
 * @return 0: success
 * @return neg: error
 */
int app_cmd_init(struct device* p_device)
{
    int rc;
    static bool initialized = false;

    rc = app_uart_init(p_device, m_rx_pool, CMD_PACKET_LENGTH);
    if (rc != 0) {
        LOG_ERR("UART device init failed");
        return -ENXIO;
    }

    state_set(&m_cmd_ctx, CMD_STATE_IDLE);

    memset(&m_cmd_ctx.cmd, 0, sizeof(app_cmd_t));

    memset(&m_rx_pool, 0, sizeof(m_rx_pool));
    memset(&m_tx_pool, 0, sizeof(m_tx_pool));
    memset(&m_rx_buff, 0, sizeof(buffer_t));
    memset(&m_tx_buff, 0, sizeof(buffer_t));

    app_uart_rx_cb_set(on_uart_rx_ready);
    app_uart_tx_cb_set(on_uart_tx_empty);

    if (!initialized) {
        initialized = true;

        m_event_cb = event_cb_dummy;

        memset(&m_cb_list, 0, sizeof(m_cb_list));

        k_work_init(&wk_proc_req, wk_proc_req_handler);
        k_work_init(&wk_proc_rsp, wk_proc_rsp_handler);

        app_cmd_add(CMD_OP_PING, req_cb_ping, rsp_cb_ping);
        app_cmd_add(CMD_OP_RAW_DATA, req_cb_raw_data, rsp_cb_raw_data);
    }

    return 0;
}

/**@brief Un-initialize app cmd module */
void app_cmd_uninit(void)
{
    app_uart_uninit();

    k_timer_stop(&tmr_wait_rsp);
}

/**@brief Callback function for ping request. */
static int req_cb_ping(uint8_t* p_req, uint16_t req_len, cmd_respond_t respond)
{
    LOG_INF("%s", __func__);

    char* rsp = "ok";
    respond(rsp, strlen(rsp));

    return 0;
}

/**@brief Callback function for ping response. */
static void rsp_cb_ping(uint8_t* p_rsp, uint16_t rsp_len)
{
    LOG_INF("%s", __func__);
}

/**@brief Callback function for raw_data request. */
static int req_cb_raw_data(uint8_t* p_req, uint16_t req_len, cmd_respond_t respond)
{
    LOG_DBG("%s", __func__);
    char* rsp = "ok";

    // TODO: fill user function to handle raw data
    if (req_len > 0) {
        LOG_HEXDUMP_INF(p_req, MIN(req_len, 8), "raw data:");
    }

    respond(rsp, strlen(rsp));

    return 0;
}

/**@brief Callback function for mtu_get response. */
static void rsp_cb_raw_data(uint8_t* p_rsp, uint16_t rsp_len)
{
    LOG_DBG("%s", __func__);

    if (rsp_len > 0) {
        LOG_HEXDUMP_INF(p_rsp, MIN(rsp_len, 8), "raw data:");
    }
}

/**@brief Send a ping request */
void cmd_request_ping(void)
{
    app_cmd_request(CMD_OP_PING, "yq", 2);
}

/**@brief Send a raw data request */
void cmd_request_raw_data(uint8_t* p_data, uint16_t length)
{
    app_cmd_request(CMD_OP_RAW_DATA, p_data, length);
}
```

## src/app_flash.c
```c
#include <zephyr.h>
#include <device.h>
#include <drivers/flash.h>
#include <storage/flash_map.h>
#include <sys/crc.h>
#include <sys/byteorder.h>
#include <sys/util.h>
#include <logging/log.h>
LOG_MODULE_REGISTER(app_flash, 3);

#include "app_flash.h"

/**@brief Get flash info
 *
 * @details Info structure: bank start address[4], page
 * count of the bank[4], the first blank page[4].
 * The first blank page is used to implement resume
 * from the break point.
 *
 * @return 0: success
 * @return neg: error
 */
int app_flash_si_slotinfo(uint8_t* p_data)
{
	int rc;
	const struct flash_area* fa;
	uint32_t bank_addr;
	uint32_t page_count;
	uint32_t first_blank;

	uint32_t p_read;
	bool  found;

	rc = flash_area_open(APP_FLASH_BANK_ID, &fa);
	if (rc) {
		return rc;
	}

	bank_addr = fa->fa_off;
	page_count = fa->fa_size / 0x1000;

	flash_area_close(fa);

	found = false;
	p_read = bank_addr;
	while (p_read < fa->fa_size) {
		for (uint32_t i = 0; i < 4096; i++) {
			if (((uint8_t*)p_read)[i] != 0xFF) {
				found = true;
				break;
			}
		}

		if (!found) {
			break;
		}

		p_read += 4096;
	}

	first_blank = MAX(bank_addr, (p_read - 4096));

	sys_put_le32(bank_addr, &p_data[0]);
	sys_put_le32(page_count, &p_data[4]);
	sys_put_le32(first_blank, &p_data[8]);

	return rc;
}

/**@brief Read flash data
 *
 * @param[in] offset: offset from the bank start
 * @param[out] p_data: pointer of data
 * @param[in] length: length of data to be read
 *
 * @return 0: success
 * @return neg: error
 */
int app_flash_read(uint32_t offset, uint8_t* p_data, uint32_t length)
{
	int rc;
	const struct flash_area* fa;

	rc = flash_area_open(APP_FLASH_BANK_ID, &fa);
	if (rc) {
		return rc;
	}

    // TODO: here should check the boundary of flash

	rc = flash_area_read(fa, offset, p_data, length);
	if (rc) {
		return rc;
	}

	flash_area_close(fa);

	return rc;
}

/**@brief Read flash data with Bank ID
 *
 * @param[in] offset: offset from the bank start
 * @param[out] p_data: pointer of data
 * @param[in] length: length of data to be read
 * @param[in] FLASH_ID: ID of Flash to be read
 * 
 * @return 0: success
 * @return neg: error
 */
int app_flash_read_id(uint32_t offset, uint8_t* p_data, uint32_t length,uint8_t FLASH_ID)
{
	int rc;
	const struct flash_area* fa;

	rc = flash_area_open(FLASH_ID, &fa);
	if (rc) {
		return rc;
	}

    // TODO: here should check the boundary of flash

	rc = flash_area_read(fa, offset, p_data, length);
	if (rc) {
		return rc;
	}

	flash_area_close(fa);

	return rc;
}
/**@brief Get Available Space for MCUBOOTSECONDARY Slot in Bytes
 *
 * @return >= 0: success
 * @return neg: error
 */
static uint32_t app_flash_get_availablesize(){

	int rc;
	const struct flash_area* fa;
	uint32_t size;

	rc = flash_area_open(APP_FLASH_BANK_ID, &fa);
	if (rc) {
		return rc;
	}

	size = fa->fa_size;

	flash_area_close(fa);
	LOG_INF("Available Size%x",size);
	return size;
}

//Get Fw Num
static int app_flash_fwnum(uint8_t* minor_fw, uint8_t* major_fw)
{
	int rc;
	
	uint8_t Data_bata[2];

	rc = app_flash_read_id(20,Data_bata,2,FLASH_AREA_ID(image_0));//4+4+2+2+4+4 20 21

	*minor_fw=Data_bata[0];
	*major_fw=Data_bata[1];

	return rc;
}

int app_flash_get_DevInf(uint8_t* buffer,uint16_t bufferlength){
	int rc = 0;
	
	if(bufferlength < 6){ //6 -> major minor version = 2 Byte + 4 byte for Available Space
		return -1;
	}

	//Retrieve FW Version
	rc = app_flash_fwnum(&buffer[0],&buffer[1]);
	sys_put_le32(app_flash_get_availablesize(),&buffer[2]);

	return rc;
}


/**@brief Write flash data
 *
 * @details If length is not word aligned, it will fill
 * 0xFF as end padding
 *
 * @param[in] offset: offset from the bank start
 * @param[in] p_data: pointer of data
 * @param[in] length: length of data to be read
 *
 * @return 0: success
 * @return neg: error
 */
int app_flash_write(uint32_t offset, uint8_t* p_data, uint32_t length)
{
	int rc;
	const struct flash_area* fa;
	uint8_t  p_last_word[4] = {0xFF, 0xFF, 0xFF, 0xFF};
	uint32_t word_align_len;

	rc = flash_area_open(APP_FLASH_BANK_ID, &fa);
	if (rc) {
		return rc;
	}

	if (length % 4 != 0) {
		word_align_len = length / 4 * 4;
	}
	else {
		word_align_len = length;
	}

	rc = flash_area_write(fa, offset, p_data, word_align_len);
	if (rc != 0) {
		return rc;
	}

	if (word_align_len < length) {
		memcpy(p_last_word, &p_data[word_align_len], (length - word_align_len));
		rc = flash_area_write(fa, offset + word_align_len, p_last_word, 4);
		if (rc) {
			return rc;
		}
	}

	flash_area_close(fa);

	return rc;
}

/**@brief Erase flash pages
 *
 * @param[in] offset: offset from the bank start
 * @param[in] count: page count to be erased
 *
 * @return 0: success
 * @return neg: error
 */
int app_flash_erase_page(uint32_t offset, uint32_t count)
{
	int rc;
	const struct flash_area* fa;
	uint32_t byte_len;

	rc = flash_area_open(APP_FLASH_BANK_ID, &fa);
	if (rc) {
		return rc;
	}

	byte_len = MIN(count * 0x1000, fa->fa_size);

	rc = flash_area_erase(fa, offset, byte_len);

	flash_area_close(fa);

	return rc;
}

/**@brief Erase flash pages from the bank end
 *
 * @param[in] offset: offset from the bank start
 * @param[in] count: page count to be erased
 *
 * @return 0: success
 * @return neg: error
 */
int app_flash_erase_from_end(uint32_t count)
{
	int rc;
	const struct flash_area* fa;
	uint32_t byte_len;
    uint32_t offset;

	rc = flash_area_open(APP_FLASH_BANK_ID, &fa);
	if (rc) {
		return rc;
	}

	byte_len = MIN(count * 0x1000, fa->fa_size);
    offset = fa->fa_size - byte_len;

	rc = flash_area_erase(fa, offset, byte_len);

	flash_area_close(fa);

	return rc;
}

/**@brief Get crc value of flash data
 *
 * @param[in] offset: offset from the bank start
 * @param[in] length: length of data to be read
 * @param[out] crc32: pointer of crc value
 *
 * @return 0: success
 * @return neg: error
 */
int app_flash_crc(uint32_t offset, uint32_t length, uint32_t* crc32)
{
	int rc;
	const struct flash_area* fa;
	uint8_t *bank_addr;
	uint32_t step = 1024;
	uint32_t crc_val = 0;
	uint32_t i;

	rc = flash_area_open(APP_FLASH_BANK_ID, &fa);
	if (rc) {
		return rc;
	}

	bank_addr = (uint8_t *)(fa->fa_off);

	if (length <= step) {
		crc_val = crc32_ieee(bank_addr, length);
	}
	else {
		crc_val = 0;

		for (i = 0; i < length / step; i++) {
			crc_val = crc32_ieee_update(crc_val, bank_addr + i * step, step);
		}
		if (length % step != 0) {
			crc_val = crc32_ieee_update(crc_val, bank_addr + i * step, length % step);
		}
	}
	*crc32 = crc_val;

	flash_area_close(fa);

	return rc;
}
```

## src/app_flash_cmd.c
```c
#include <zephyr.h>
#include <device.h>
#include <sys/byteorder.h>
#include <logging/log.h>
LOG_MODULE_REGISTER(cmd_flash, 3);

#include "app_cmd.h"
#include "app_flash.h"
#include "app_flash_cmd.h"

/*---------------------------------------------------------------------------------*/
//Requests
/*---------------------------------------------------------------------------------*/


/**@brief Callback of flash read request
 *
 * @details Request: address offset[4], data length[4]
 * Response: read data or none
 *
 * @param[in] p_req     Pointer of request data
 * @param[in] req_len   Length of request data
 * @param[in] respond   Callback function of responding
 *
 * @return 0 success
 * @return neg error
 */
static int req_cb_flash_read(uint8_t* p_req, uint16_t req_len, cmd_respond_t respond)
{
    LOG_DBG("%s", __func__);

    int   rc;
    uint8_t* p_rsp;
    uint16_t rsp_len;

    uint32_t offset = sys_get_le32(&p_req[0]);
    uint32_t length = sys_get_le32(&p_req[4]);

    LOG_INF("read offset: %x, length: %d", offset, length);

    rsp_len = length;

    p_rsp = k_malloc(rsp_len);

    if (p_rsp != NULL) {
        rc = app_flash_read(offset, p_rsp, length);
        if (rc == 0) {
            respond(p_rsp, rsp_len);
            k_free(p_rsp);
        }
        else {
            respond(NULL, 0);
        }
    }
    else {
        rc = -1;
        respond(NULL, 0);
    }

    return rc;
}

/**@brief Callback of flash write request
 *
 * @details Request: address offset[4], data length[4],
 * data[N]. Response: "ok" or none
 *
 * @param[in] p_req     Pointer of request data
 * @param[in] req_len   Length of request data
 * @param[in] respond   Callback function of responding
 *
 * @return 0 success
 * @return neg error
 */
static int req_cb_flash_write(uint8_t* p_req, uint16_t req_len, cmd_respond_t respond)
{
    LOG_DBG("%s", __func__);

    int rc = 0;

    uint32_t offset = sys_get_le32(&p_req[0]);
    uint32_t length = sys_get_le32(&p_req[4]);
    uint8_t* p_data = &p_req[8];

    LOG_INF("write offset: %x, length: %d", offset, length);

    rc = app_flash_write(offset, p_data, length);
    if (rc == 0) {
        respond("ok", 2);
    }
    else {
        respond(NULL, 0);
    }

    return rc;
}

/**@brief Callback of flash erase request
 *
 * @details Request: address offset[4], page count[4]
 * Response: "ok" or none
 *
 * @param[in] p_req     Pointer of request data
 * @param[in] req_len   Length of request data
 * @param[in] respond   Callback function of responding
 *
 * @return 0 success
 * @return neg error
 */
static int req_cb_flash_erase(uint8_t* p_req, uint16_t req_len, cmd_respond_t respond)
{
    LOG_DBG("%s", __func__);

    int rc;
    uint32_t offset = sys_get_le32(&p_req[0]);
    uint32_t count = sys_get_le32(&p_req[4]);

    rc = app_flash_erase_page(offset, count);
    if (rc == 0) {
        respond("ok", 2);
    }
    else {
        respond(NULL, 0);
    }

    LOG_INF("erase offset: %x, count: %d", offset, count);

    return rc;
}

/**@brief Callback of flash crc request
 *
 * @details Request: address offset[4], data length[4]
 * Response: crc32[4] or none
 *
 * @param[in] p_req     Pointer of request data
 * @param[in] req_len   Length of request data
 * @param[in] respond   Callback function of responding
 *
 * @return 0 success
 * @return neg error
 */
static int req_cb_flash_crc(uint8_t* p_req, uint16_t req_len, cmd_respond_t respond)
{
    LOG_DBG("%s", __func__);

    int rc;
    uint8_t  p_rsp[4];
    uint16_t rsp_len = 4;

    uint32_t crc32;
    uint32_t offset = sys_get_le32(&p_req[0]);
    uint32_t length = sys_get_le32(&p_req[4]);

    LOG_INF("crc offset: %x, length: %d", offset, length);

    rc = app_flash_crc(offset, length, &crc32);
    if (rc == 0) {
        sys_put_le32(crc32, p_rsp);
        respond(p_rsp, rsp_len);
    }
    else {
        respond(NULL, 0);
    }

    return rc;
}

/**@brief Callback of flash start request
 *
 * @details Request: none
 * Response: "ok"
 *
 * @param[in] p_req     Pointer of request data
 * @param[in] req_len   Length of request data
 * @param[in] respond   Callback function of responding
 *
 * @return 0 success
 * @return neg error
 */
static int req_cb_flash_start(uint8_t* p_req, uint16_t req_len, cmd_respond_t respond)
{
    LOG_DBG("%s", __func__);

    respond("ok", 2);

    return 0;
}

/**@brief Callback of flash done request
 *
 * @details Request: none
 * Response: "ok"
 *
 * @param[in] p_req     Pointer of request data
 * @param[in] req_len   Length of request data
 * @param[in] respond   Callback function of responding
 *
 * @return 0 success
 * @return neg error
 */
static int req_cb_flash_done(uint8_t* p_req, uint16_t req_len, cmd_respond_t respond){
    LOG_DBG("%s", __func__);

    respond("ok", 2);

    return 0;
}

/**@brief Register flash related commands
 *
 * @param cb: event callback function
 */
void app_flash_cmd_init(void)
{
    app_cmd_add(CMD_OP_FLASH_WRITE_92, req_cb_flash_write, NULL);
    app_cmd_add(CMD_OP_FLASH_ERASE_92, req_cb_flash_erase, NULL);
    app_cmd_add(CMD_OP_FLASH_DONE_92,  req_cb_flash_done, NULL);

    app_cmd_add(CMD_OP_FLASH_READ_92,  req_cb_flash_read, NULL);
    app_cmd_add(CMD_OP_FLASH_CRC_92,   req_cb_flash_crc, NULL);
    app_cmd_add(CMD_OP_FLASH_START_92, req_cb_flash_start, NULL);

}
```

## src/app_flash_cmd.h
```c
#ifndef APP_FLASH_CMD_H__
#define APP_FLASH_CMD_H__

#include <zephyr.h>
#include "app_cmd.h"

#ifdef __cplusplus
extern "C" {
#endif

// app flash commands: 0x20 - 0x2F
#define CMD_OP_FLASH_52        0x20
#define CMD_OP_FLASH_INFO_52   (CMD_OP_FLASH_52 + 1)
#define CMD_OP_FLASH_READ_52   (CMD_OP_FLASH_52 + 2)
#define CMD_OP_FLASH_WRITE_52  (CMD_OP_FLASH_52 + 3)
#define CMD_OP_FLASH_ERASE_52  (CMD_OP_FLASH_52 + 4)
#define CMD_OP_FLASH_CRC_52    (CMD_OP_FLASH_52 + 5)
#define CMD_OP_FLASH_START_52  (CMD_OP_FLASH_52 + 6)
#define CMD_OP_FLASH_DONE_52   (CMD_OP_FLASH_52 + 7)
	
// app flash commands 92: 0x30 - 0x2F#
#define CMD_OP_FLASH_92        0x30
#define CMD_OP_FLASH_INFO_92   (CMD_OP_FLASH_92 + 1)
#define CMD_OP_FLASH_READ_92   (CMD_OP_FLASH_92 + 2)
#define CMD_OP_FLASH_WRITE_92  (CMD_OP_FLASH_92 + 3)
#define CMD_OP_FLASH_ERASE_92  (CMD_OP_FLASH_92 + 4)
#define CMD_OP_FLASH_CRC_92    (CMD_OP_FLASH_92 + 5)
#define CMD_OP_FLASH_START_92  (CMD_OP_FLASH_92 + 6)
#define CMD_OP_FLASH_DONE_92   (CMD_OP_FLASH_92 + 7)




/**@brief Register flash related commands
 *
 * @param cb: event callback
 */
void app_flash_cmd_init(void);

#ifdef __cplusplus
}
#endif

#endif /* APP_FLASH_CMD_H__ */
```

## src/http_client.c
```c
#include <string.h>
#include <stdio.h>
#include <zephyr.h>
#include <device.h>
#include <net/socket.h>
#include <modem/lte_lc.h>

#include <modem/nrf_modem_lib.h>
#include <net/fota_download.h>
#include <logging/log.h>
LOG_MODULE_REGISTER(http_client, 4);

#include "http_client.h"

#define HTTP_HOST_LEN_MAX   50
#define HTTP_FILE_LEN_MAX   30

static struct k_work	 wk_http_download;

fota_download_callback_t m_user_download_cb;

static char m_http_host[HTTP_HOST_LEN_MAX];
static char m_http_file[HTTP_FILE_LEN_MAX];
static uint32_t m_file_size;
static bool downloading;

/**@brief Handler for HTTP download worker */
static void http_download_handler(struct k_work* unused)
{
    int rc;
    int sec_tag = -1;
    char* apn = NULL;
    int port = 0;       // HTTP, not HTTPS

    rc = fota_download_start(m_http_host, m_http_file, sec_tag, apn, port);
    if (rc) {
        LOG_ERR("Download file error, %d", rc);
    }
}

/**@brief Start to HTTP download */
int http_client_download(char* host, char* file)
{
    if (downloading) {
        return 0;
    }

    if (strlen(file) > HTTP_FILE_LEN_MAX) {
        LOG_ERR("File path len should be less than %d bytes", HTTP_FILE_LEN_MAX);
        return -1;
    }

    if (strlen(host) > HTTP_HOST_LEN_MAX) {
        LOG_ERR("Host len should be less than %d bytes", HTTP_HOST_LEN_MAX);
        return -1;
    }

    memcpy(m_http_host, host, strlen(host));
    memcpy(m_http_file, file, strlen(file));

    k_work_submit(&wk_http_download);

    downloading = true;

    return 0;
}

/**@brief HTTP download event handler */
static void download_handler(const struct fota_download_evt* evt)
{
    switch (evt->id) {
    case FOTA_DOWNLOAD_EVT_FINISHED:
        LOG_DBG("Download event finished");
        m_file_size= fota_download_file_size();
        downloading = false;
        break;

    case FOTA_DOWNLOAD_EVT_ERROR:
        LOG_ERR("Download event error");
        downloading = false;
        break;

    case FOTA_DOWNLOAD_EVT_PROGRESS:
    case FOTA_DOWNLOAD_EVT_ERASE_PENDING:
    case FOTA_DOWNLOAD_EVT_ERASE_DONE:
    default:
        LOG_DBG("Download event: %d", evt->id);
        break;
    }

    if (m_user_download_cb) {
        m_user_download_cb(evt);
    }
}

/**@brief Start to connect LTE network */
int http_client_connect(void)
{
    return lte_lc_init_and_connect();
}

/**@brief Initialize http client module  */
int http_client_init(fota_download_callback_t download_callback)
{
    int rc;
    
    downloading = false;
    m_user_download_cb = download_callback;

    LOG_DBG("http_client_init\n");

    rc = nrf_modem_lib_get_init_ret();    
    /* Handle return values relating to modem firmware update */
    switch (rc) {
    case 0:
        /* Initialization successful, no action required. */
        break;
    case MODEM_DFU_RESULT_OK:
        LOG_INF("MODEM UPDATE OK. Will run new firmware after reboot");
        
        // TODO: reset?
        k_thread_suspend(k_current_get());
        break;
    case MODEM_DFU_RESULT_UUID_ERROR:
    case MODEM_DFU_RESULT_AUTH_ERROR:
        LOG_ERR("MODEM UPDATE ERROR %d. Will run old firmware", rc);
        break;
    case MODEM_DFU_RESULT_HARDWARE_ERROR:
    case MODEM_DFU_RESULT_INTERNAL_ERROR:
        LOG_ERR("MODEM UPDATE FATAL ERROR %d. Modem failure", rc);
        break;
    default:
        /* All non-zero return codes other than DFU result codes are
         * considered irrecoverable and a reboot is needed.
         */
        LOG_ERR("nRF modem lib initialization failed, error: %d", rc);
        break;
    }


    rc = fota_download_init(download_handler);
    if (rc) {
        LOG_ERR("FOTA init error.");
        return rc;
    }

    k_work_init(&wk_http_download, http_download_handler);

    return rc;
}
uint32_t get_file_size(void){
    LOG_ERR("File Size is Currently commented out");
    return m_file_size;
}
```

## src/http_client.h
```c
#ifndef HTTP_CLIENT_H__
#define HTTP_CLIENT_H__

#include <zephyr.h>
#include <net/fota_download.h>

#ifdef __cplusplus
extern "C" {
#endif

/**@brief Initialize http client module 
 * 
 * @param[in] download_client: fota download callback 
 *
 * @return 0: success
 * @return neg: error
 */
int http_client_init(fota_download_callback_t download_callback);

/**@brief Start to connect LTE network */
int http_client_connect(void);

/**@brief Start to HTTP download 
 *
 * @param[in] host: host name
 * @param[in] file: file path
 *
 * @return 0: success
 * @return neg: error
 */
int http_client_download(char* host, char* file);

/**@brief Gets File_Size
 *
 * @return neg: error
 */
uint32_t get_file_size(void);
#ifdef __cplusplus
}
#endif

#endif /* HTTP_CLIENT_H__ */
```
