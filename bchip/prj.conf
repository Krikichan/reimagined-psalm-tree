## CMakeLists.txt
```
# SPDX-License-Identifier: Apache-2.0

cmake_minimum_required(VERSION 3.20.0)

if (EXISTS "${CMAKE_CURRENT_SOURCE_DIR}/mcuboot.conf")
    list(APPEND mcuboot_OVERLAY_CONFIG
      "${CMAKE_CURRENT_SOURCE_DIR}/mcuboot.conf"
      )
endif()

find_package(Zephyr REQUIRED HINTS $ENV{ZEPHYR_BASE})
project(bchip_dfu)

zephyr_include_directories(src)
zephyr_include_directories(libs/simp)
zephyr_include_directories(libs/flash)
zephyr_include_directories(libs/dfu_module)

#Library adds
target_sources(app PRIVATE libs/dfu_module/dfu_module_52.c)
target_sources(app PRIVATE libs/simp/uart_drv.c)
target_sources(app PRIVATE libs/simp/simp.c)
target_sources(app PRIVATE libs/flash/app_flash.c)

target_sources(app PRIVATE src/main.c)

zephyr_library_include_directories(.)
```

## prj.conf
```kconfig
# Enable the UART driver
CONFIG_SERIAL=y
CONFIG_UART_ASYNC_API=y
CONFIG_NRFX_UARTE=y
CONFIG_NRFX_UARTE1=y
CONFIG_NRFX_TIMER2=y
CONFIG_UART_1_NRF_HW_ASYNC=y
CONFIG_UART_1_NRF_HW_ASYNC_TIMER=1

#Gpio
CONFIG_GPIO=y
CONFIG_PM=y

CONFIG_NEWLIB_LIBC=y
CONFIG_NEWLIB_LIBC_FLOAT_PRINTF=y

### Enable k_malloc/k_free
CONFIG_HEAP_MEM_POOL_SIZE=4096
CONFIG_MAIN_STACK_SIZE=8192

#Enable Reboot
CONFIG_REBOOT=y 

##Flash
CONFIG_FLASH=y
CONFIG_IMG_MANAGER=y
CONFIG_IMG_ERASE_PROGRESSIVELY=y
CONFIG_MPU_ALLOW_FLASH_WRITE=y		# Necessary for flash map write/erase operation

#Enable Bluetooth
CONFIG_BT=y
CONFIG_BT_PERIPHERAL=y
CONFIG_BT_DEVICE_NAME="App_Chip"
CONFIG_BT_L2CAP_TX_BUF_COUNT=2
CONFIG_BT_DEVICE_APPEARANCE=833
CONFIG_BT_MAX_CONN=1
CONFIG_BT_MAX_PAIRED=1
CONFIG_SETTINGS=y

CONFIG_BT_USER_DATA_LEN_UPDATE=y

CONFIG_BT_GATT_CLIENT=y

CONFIG_BT_ATT_PREPARE_COUNT=2
CONFIG_BT_L2CAP_TX_MTU=247
CONFIG_BT_CTLR_RX_BUFFERS=4

#Dont Touch MTU eintsellung Eingestellte Zahl -7 ist available
CONFIG_BT_BUF_ACL_RX_SIZE=136
CONFIG_BT_CTLR_DATA_LENGTH_MAX=136

# Enable the NUS service
CONFIG_BT_NUS=y

# Enable bonding
CONFIG_BT_SETTINGS=y
CONFIG_FLASH=y
CONFIG_FLASH_PAGE_LAYOUT=y
CONFIG_FLASH_MAP=y
CONFIG_NVS=y
CONFIG_SETTINGS=y
CONFIG_MPU_ALLOW_FLASH_WRITE=y

# Enable DK LED and Buttons library
CONFIG_DK_LIBRARY=y

#More workqueue stack
CONFIG_SYSTEM_WORKQUEUE_STACK_SIZE=4096

# Config logger
CONFIG_LOG=y
CONFIG_LOG_MODE_IMMEDIATE=y

CONFIG_UART_CONSOLE=n
CONFIG_RTT_CONSOLE=y

CONFIG_USE_SEGGER_RTT=y
CONFIG_LOG_BACKEND_RTT=y
CONFIG_LOG_BACKEND_UART=n

#Allow Asserts
CONFIG_ASSERT=y

#Activate MCUBoot
CONFIG_BOOTLOADER_MCUBOOT=y
CONFIG_DFU_TARGET=y
```

## nrf52840dk_nrf52840.overlay
```dts
// To get started, press Ctrl+Space to bring up the completion menu and view the available nodes.
// For more help, browse the DeviceTree documentation at https://docs.zephyrproject.org/latest/guides/dts/index.html

&uart1 {
    rx-pin = <6>;
    tx-pin = <8>;
    label = "UART_1";
    current-speed = < 230400 >;
    status = "okay";
    rx-pull-up;
};
&uart0 {
    status = "disabled";
};

&gpiote {
    interrupts = <6 NRF_DEFAULT_IRQ_PRIORITY>;
};
```

## src/main.c
```c
/** @file
 *  @brief Bluetooth Application Chip Programm Enabling DFU of the Chip Structure
 */
#include <zephyr/types.h>
#include <zephyr.h>
#include <drivers/uart.h>
#include <usb/usb_device.h>

#include <sys/reboot.h>

#include <device.h>
#include <soc.h>
#include <sys/byteorder.h>
#include <dfu/dfu_target.h>
#include <dfu/mcuboot.h>

#include <bluetooth/bluetooth.h>
#include <bluetooth/uuid.h>
#include <bluetooth/gatt.h>
#include <bluetooth/hci.h>

#include <bluetooth/services/nus.h>

#include <dk_buttons_and_leds.h>

#include <settings/settings.h>

#include <stdio.h>

#include <logging/log.h>
#include <dfu/mcuboot.h>

#include "simp.h"
#include "app_flash.h"
#include "dfu_module_52.h"

LOG_MODULE_REGISTER(main,3);
//Bluetooth Config
#define DEVICE_NAME "Appli"
#define DEVICE_NAME_LEN	(sizeof(DEVICE_NAME) - 1)

#define CMD_OP_GO_TO_SLEEP			0xC0

static K_SEM_DEFINE(ble_init_ok, 0, 1);

#define UART_DEVICE_LABEL "UART_1"

#define RUN_STATUS_LED DK_LED1
#define RUN_LED_BLINK_INTERVAL 1000

#define CON_STATUS_LED DK_LED2

#define UPDATE_APP 					false

static struct device *uart;

static struct bt_conn *current_conn;

static const struct bt_data ad[] = {
	BT_DATA_BYTES(BT_DATA_FLAGS, (BT_LE_AD_GENERAL | BT_LE_AD_NO_BREDR)),
	BT_DATA(BT_DATA_NAME_COMPLETE, DEVICE_NAME, DEVICE_NAME_LEN),
};

static const struct bt_data sd[] = {
	BT_DATA_BYTES(BT_DATA_UUID128_ALL, BT_UUID_NUS_VAL),
};


static void connected(struct bt_conn *conn, uint8_t err)
{
	char addr[BT_ADDR_LE_STR_LEN];
	struct bt_conn_info info; 	
	if (err) {
		LOG_ERR("Connection failed (err %u)", err);
		return;

	}	else if(bt_conn_get_info(conn, &info)){
		printk("Could not parse connection info\n");
		return;
	}else{

	bt_addr_le_to_str(bt_conn_get_dst(conn), addr, sizeof(addr));
	LOG_INF("Connected %s", log_strdup(addr));
	LOG_INF("Connection established!		\n\
		Connected to: %s					\n\
		Role: %u							\n\
		Connection interval: %u				\n\
		Slave latency: %u					\n\
		Connection supervisory timeout: %u	"
		, addr, info.role, info.le.interval, info.le.latency, info.le.timeout);
	}
	

	current_conn = bt_conn_ref(conn);

	dk_set_led_on(CON_STATUS_LED);
}

static void disconnected(struct bt_conn *conn, uint8_t reason)
{
	char addr[BT_ADDR_LE_STR_LEN];

	bt_addr_le_to_str(bt_conn_get_dst(conn), addr, sizeof(addr));

	LOG_INF("Disconnected: %s (reason %u)", log_strdup(addr), reason);


	if (current_conn) {
		bt_conn_unref(current_conn);
		current_conn = NULL;
		dk_set_led_off(CON_STATUS_LED);
	}
}

static bool le_param_req(struct bt_conn *conn, struct bt_le_conn_param *param)
{
	//If acceptable params, return true, otherwise return false.
	return true; 
}

static void le_param_updated(struct bt_conn *conn, uint16_t interval, uint16_t latency, uint16_t timeout)
{
	struct bt_conn_info info; 
	char addr[BT_ADDR_LE_STR_LEN];
	
	if(bt_conn_get_info(conn, &info))
	{
		printk("Could not parse connection info\n");
	}
	else
	{
		bt_addr_le_to_str(bt_conn_get_dst(conn), addr, sizeof(addr));
		
		printk("Connection parameters updated!	\n\
		Connected to: %s						\n\
		New Connection Interval: %u				\n\
		New Slave Latency: %u					\n\
		New Connection Supervisory Timeout: %u	\n"
		, addr, info.le.interval, info.le.latency, info.le.timeout);
	}
}



static struct bt_conn_cb conn_callbacks = {
	.connected		    = connected,
	.disconnected   	= disconnected,
	.le_param_req		= le_param_req,
	.le_param_updated	= le_param_updated
};


static struct bt_nus_cb nus_cb = {
	.received = nus_received_cb_handler
};

void error(void)
{
	dk_set_leds_state(DK_ALL_LEDS_MSK, DK_NO_LEDS_MSK);

	while (true) {
		/* Spin for ever */
		k_sleep(K_MSEC(1000));
	}
}

/**@brief app_cmd request & response event handler.
 *		 Note, don't run long-time task here. 
 */
static void app_cmd_event_handler(cmd_event_t* p_event)
{

	switch (p_event->op_code) {
	case CMD_OP_FLASH_INFO_52:
		LOG_INF("Start to receive DFU image by UART");
		break;

	case CMD_OP_FLASH_DONE_52:
		LOG_INF("DFU image is received by UART");
		LOG_INF("File size is: %d", sys_get_le32(p_event->p_data));	
		dfu_file_ready(IMAGE_FROM_SERIAL);

		break;
	default:
		LOG_DBG("cmd op: 0x%02x", p_event->op_code);
		break;
	}
}

void rsp_nrf91_sleep(uint8_t* p_rsp, uint16_t rsp_len){
	LOG_INF("NRF91 is now Sleepy");
	//Todo Maybe remember that nrf91 is sleeping -> boolean
}

static void bt_ready(int err)
{
	LOG_INF("BT Host Stack enabled");
	if (err) {
		printk("BLE init failed with error code %d\n", err);
		return;
	}
	
	bt_conn_cb_register(&conn_callbacks);
	
	if (IS_ENABLED(CONFIG_SETTINGS)) {
		settings_load();
	}
	
	err = bt_nus_init(&nus_cb);// ->dfu_helper file

	if (err) {
		LOG_ERR("Failed to initialize UART service (err: %d)", err);
		return;
	}
    //Start advertising
	err = bt_le_adv_start(BT_LE_ADV_CONN, ad, ARRAY_SIZE(ad), sd,
			      ARRAY_SIZE(sd));

	if (err) 
	{
		printk("Advertising failed to start (err %d)\n", err);
		return;
	}

	k_sem_give(&ble_init_ok);
}


/**@brief Do mcuboot dfu for 52 */
void do_mcuboot_dfu(void)
{
	LOG_INF("Rebooting ....");
	sys_reboot(SYS_REBOOT_WARM);
}

void button_handel(uint32_t button_state,uint32_t has_changed){
	int err;
	if(DK_BTN1_MSK & button_state){
	}
	if(DK_BTN2_MSK & button_state){
		do_mcuboot_dfu();
	}
}

void main(void)
{

	int err = 0;

#if UPDATE_APP
	LOG_INF("Cross DFU Demo(new)");
#else
	LOG_INF("Cross DFU Demo(ori)");
#endif

	err = dk_leds_init();
	if (err) {
		LOG_ERR("Cannot init LEDs (err: %d)", err);
	}
	err = dk_buttons_init(button_handel);
	if (err) {
		LOG_ERR("Cannot init Buttons (err: %d)", err);
	}

#if UPDATE_APP
	err = dk_set_led(DK_LED4,1);
#else
	err = dk_set_led(DK_LED3,1);
#endif
	if(err){
		LOG_ERR("Set Led err %d",err);
	}

	uart = device_get_binding(UART_DEVICE_LABEL);
	if (!uart) {
		LOG_ERR("Cant init Uart Component");
		return;
	}

	err = bt_enable(bt_ready);
	if (err) {
		error();
	}

	err = k_sem_take(&ble_init_ok, K_MSEC(100));
	//Need to wait here
	k_sem_give(&ble_init_ok);
	/* All initializations were successful mark image as working so that we
	 * will not revert upon reboot.
	 */
	boot_write_img_confirmed();

    app_cmd_init(uart);
	app_cmd_event_cb_register(app_cmd_event_handler);

	app_cmd_add(CMD_OP_GO_TO_SLEEP,NULL,NULL);

	initalize_dfu_module();

	LOG_INF("Init completed, Idling till Update or Connect");
	
	//Forever Loop :^)
	for (;;) {
		k_sleep(K_SECONDS(10));
	}
}

//TODO Add Options for App like seeing Cur FW Num Available Size let User Decide wether to Update or not
//-> have to send current 
//-> Make own Service for communication 
//-> Use Nordic Uart only for FWData Transfer

//If In Production write a extension for NUS so you dont have to different services rather more attributes
```

## src/app_cmd.c
```c
#include <string.h>
#include <zephyr.h>
#include <device.h>
#include <sys/byteorder.h>
#include <sys/crc.h>
#include <logging/log.h>
LOG_MODULE_REGISTER(cmd, 4);

#include "app_cmd.h"
#include "app_uart.h"

#define SKIP_CRC_CHECK                  false            /* Switch option to skip CRC check or not */

#define CMD_PACKET_LENGTH               1040
#define CMD_POOL_DEPTH                  2
#define CMD_CB_LIST_LEN                 20

#define crc16_compute(p_data, len)      crc16_itu_t(0x0, p_data, len)
#define uint16_decode(p_data)           sys_get_le16(p_data)
#define uint16_encode(value, p_data)    sys_put_le16(value, p_data)

/* Time between requset sent to response received is:
 * slave process request, slave send response data.
 * Host must set a long enough time to wait it, and
 * there should be a timer refresh feature, to avoid
 * timeout is triggered during UART is in active.
 *
 * Note, this value can't be small, some activities such 
 * as flash erase will cost several seconds
 */
#define WAIT_RSP_TIMEOUT                K_MSEC(10000)

 /* string names of each cmd state */
const static char* cmd_state_str[] = {
    "idle", "req_sending", "req_sent",
    "req_receiving", "req_received",
    "rsp_sending", "rsp_sent",
    "rsp_receiving", "rsp_received",
    "err_timeout", "err_sending",
    "err_receiving",
};

const static char* cmd_mode_str[] = {
    "idle", "host", "slave"
};

typedef struct
{
    uint8_t*   p_data;                 /* Pointer of data */
    uint16_t   length;                 /* Data length of the buffer */
    uint16_t   offset;                 /* Datat offset of the buffer */
} buffer_t;

static uint8_t          m_rx_pool[CMD_PACKET_LENGTH];
static uint8_t          m_tx_pool[CMD_PACKET_LENGTH];

static cmd_context_t    m_cmd_ctx;

static buffer_t         m_rx_buff;
static buffer_t         m_tx_buff;

static cmd_event_cb_t   m_event_cb;

static struct k_work    wk_proc_req;               /* A k_work to process request */
static struct k_work    wk_proc_rsp;               /* A k_work to process response */

static cmd_cb_t m_cb_list[CMD_CB_LIST_LEN];    /* User cmd list */

/* Function declaration */
static int req_cb_ping(uint8_t* p_req, uint16_t req_len, cmd_respond_t respond);
static void rsp_cb_ping(uint8_t* p_rsp, uint16_t rsp_len);
static void rsp_cb_raw_data(uint8_t* p_rsp, uint16_t rsp_len);
static int req_cb_raw_data(uint8_t* p_req, uint16_t req_len, cmd_respond_t respond);
static void state_handler(cmd_context_t* p_cmd_ctx);
static int buff_to_cmd(buffer_t* p_buff, app_cmd_t* p_cmd);
static int app_cmd_respond(uint8_t* p_data, uint16_t length);
static void tmr_rsp_timeout_handler(struct k_timer* timer);

/* Timer for waiting response */
K_TIMER_DEFINE(tmr_wait_rsp, tmr_rsp_timeout_handler, NULL);


/**@brief Dummy function of cmd event callback */
static void event_cb_dummy(cmd_event_t* p_event) {;}

/**@brief Check the crc of data sequence with a target crc
 *
 * @param[in] p_data: pointer of the data
 * @param[in] length: data length
 * @param[in] crc_target: target crc
 *
 * @return true: crc matches
 *         false: crc doesn't match
 */
static bool crc16_check(uint8_t* p_data, uint16_t length, uint16_t crc_target)
{
#ifdef SKIP_CRC_CHECK
    if (SKIP_CRC_CHECK) {
        return true;
    }
#endif

    return crc16_compute(p_data, length) == crc_target;
}

/**@brief Allocate a buffer from the pool
 *
 * @note There may be better solution
 *
 * @param[in] p_pool: pointer of data pool
 * @param[in] p_buff: pointer of buffer
 */
static void buff_alloc(uint8_t* p_pool, buffer_t* p_buff)
{
    __ASSERT_NO_MSG(p_pool != NULL);
    __ASSERT_NO_MSG(p_buff != NULL);

    p_buff->p_data = p_pool;
    p_buff->length = 0;
    p_buff->offset = 0;
}

/**@brief Set cmd state */
static void state_set(cmd_context_t* p_cmd_ctx, cmd_state_t new_state)
{
    cmd_state_t old_state = p_cmd_ctx->state;

    if (old_state != new_state) {
        p_cmd_ctx->state = new_state;

        // Always don't enable this print because it may cause 
        // UART data loss when receiving
        //LOG_DBG("State: %s -> %s",      \
            cmd_state_str[old_state],   \
            cmd_state_str[new_state]);

        state_handler(p_cmd_ctx);
    }
}

/**@brief Set a new cmd mode */
static void mode_set(cmd_context_t* p_cmd_ctx, cmd_mode_t new_mode)
{
    cmd_mode_t old_mode = p_cmd_ctx->mode;
    if (old_mode != new_mode) {
        p_cmd_ctx->mode = new_mode;

        // Always don't enable this print because it may cause 
        // UART data loss when receiving
        //LOG_DBG("Mode: %s -> %s", \
            cmd_mode_str[old_mode], \
            cmd_mode_str[new_mode]);
    }
}

/**@brief Get current cmd mode */
static cmd_mode_t mode_get(cmd_context_t* p_cmd_ctx)
{
    return p_cmd_ctx->mode;
}

/**@brief Get current cmd state */
static cmd_state_t state_get(cmd_context_t* p_cmd_ctx)
{
    return p_cmd_ctx->state;
}

/**@brief State change handler */
static void state_handler(cmd_context_t* p_cmd_ctx)
{
    cmd_state_t state = p_cmd_ctx->state;

    switch (state) {

    case CMD_STATE_IDLE:
        app_uart_rx_reset();
        mode_set(p_cmd_ctx, CMD_MODE_IDLE);
        LOG_DBG("--------------");
        break;

    case CMD_STATE_REQ_SENDING:
        mode_set(p_cmd_ctx, CMD_MODE_HOST);
        break;

    case CMD_STATE_REQ_SENT:
        /* Issue an one shot timer */
        k_timer_start(&tmr_wait_rsp, WAIT_RSP_TIMEOUT, K_NO_WAIT);
        break;

    case CMD_STATE_RSP_RECEIVING:
        /* TODO: Refresh timer count, to avoid
         * timeout during UART receiving. Now I 
         * set a very long timeout value so it's 
         * safe. */
        break;

    case CMD_STATE_RSP_RECEIVED:
        k_timer_stop(&tmr_wait_rsp);
        k_work_submit(&wk_proc_rsp);
        break;

    case CMD_STATE_REQ_RECEIVING:
        mode_set(p_cmd_ctx, CMD_MODE_SLAVE);
        break;

    case CMD_STATE_REQ_RECEIVED:
        k_work_submit(&wk_proc_req);
        break;

    case CMD_STATE_ERR_TIMEOUT:
        state_set(p_cmd_ctx, CMD_STATE_IDLE);
        break;

    case CMD_STATE_ERR_RECEIVE:
        if (mode_get(&m_cmd_ctx) != CMD_MODE_HOST) {
            state_set(p_cmd_ctx, CMD_STATE_IDLE);
        }
        break;

    case CMD_STATE_RSP_SENT:
    case CMD_STATE_ERR_SEND:
        state_set(p_cmd_ctx, CMD_STATE_IDLE);
        break;

    case CMD_STATE_RSP_SENDING:
    default:
        /* Do nothing */
        break;
    }
}

/**@brief Handler for sending cmd start */
static void on_cmd_send_start(void)
{
    LOG_DBG("%s", __func__);

    if (mode_get(&m_cmd_ctx) == CMD_MODE_SLAVE) {
        state_set(&m_cmd_ctx, CMD_STATE_RSP_SENDING);
    }
    else {
        state_set(&m_cmd_ctx, CMD_STATE_REQ_SENDING);
    }
}

/**@brief Handler for sending cmd complete */
static void on_cmd_send_complete(void)
{
    LOG_DBG("%s", __func__);

    if (mode_get(&m_cmd_ctx) == CMD_MODE_HOST) {
        state_set(&m_cmd_ctx, CMD_STATE_REQ_SENT);
    }
    else if (mode_get(&m_cmd_ctx) == CMD_MODE_SLAVE) {
        state_set(&m_cmd_ctx, CMD_STATE_RSP_SENT);
    }
    else {
        LOG_ERR("Should not come here");
    }
}

/**@brief Handler for sending cmd error */
static void on_cmd_send_error(void)
{
    LOG_ERR("%s", __func__);

    state_set(&m_cmd_ctx, CMD_STATE_ERR_SEND);
}

/**@brief Handler for receiving cmd start */
static void on_cmd_receive_start(void)
{
    LOG_DBG("%s", __func__);

    if (mode_get(&m_cmd_ctx) == CMD_MODE_HOST) {
        state_set(&m_cmd_ctx, CMD_STATE_RSP_RECEIVING);
    }
    else {
        state_set(&m_cmd_ctx, CMD_STATE_REQ_RECEIVING);
    }
}

/**@brief Handler for receiving cmd complete */
static void on_cmd_receive_complete(void)
{
    LOG_DBG("%s", __func__);

    if (mode_get(&m_cmd_ctx) == CMD_MODE_HOST) {
        state_set(&m_cmd_ctx, CMD_STATE_RSP_RECEIVED);
    }
    else if (mode_get(&m_cmd_ctx) == CMD_MODE_SLAVE) {
        state_set(&m_cmd_ctx, CMD_STATE_REQ_RECEIVED);
    }
    else {
        LOG_WRN("Should not come here");
    }
}

/**@brief Handler for receiving cmd error */
static void on_cmd_receive_error(void)
{
    LOG_ERR("%s", __func__);

    state_set(&m_cmd_ctx, CMD_STATE_ERR_RECEIVE);
}

/**@brief Get element count of cmd list */
int cmd_cb_cnt(void)
{
    for (int i = 0; i < CMD_CB_LIST_LEN; i++) {
        if (m_cb_list[i].op_code == 0) {
            return i;
        }
    }

    return CMD_CB_LIST_LEN;
}

/**@brief Get element of cmd list by op code 
 *
 * @param[in] op_code: op code of cmd
 * @param[out] p_cmd_cb: pointer of cmd callback, it can be NULL
 *
 * @return -1: not found
 *         others(>=0): index of the cmd callback
 */
static int cmd_cb_get(uint8_t op_code, cmd_cb_t* p_cmd_cb)
{
    int rc;
    int count;

    rc = -1;
    count = cmd_cb_cnt();

    for (int i = 0; i < count; i++) {
        if (m_cb_list[i].op_code == op_code) {
            if (p_cmd_cb != NULL) {
                p_cmd_cb->proc_req = m_cb_list[i].proc_req;
                p_cmd_cb->proc_rsp = m_cb_list[i].proc_rsp;
            }

            rc = 0;
            break;
        }
    }

    return rc;
}

/**@brief Add a cmd to the list
 *
 * @param[in] op_code: op code of cmd
 * @param[in] req_cb: request callback function
 * @param[in] rsp_cb: response callback function
 *
 * @return 0: success
 * @return -1: cmd list is full
 * @return -2: op code is existed
 */
int app_cmd_add(uint8_t op_code, req_cb_t req_cb, rsp_cb_t rsp_cb)
{
    cmd_cb_t callback;
    int count;

    count = cmd_cb_cnt();
    if (count == CMD_CB_LIST_LEN) {
        LOG_ERR("Cmd list is full");
        return -1;
    }

    if (cmd_cb_get(op_code, NULL) == 0) {
        LOG_WRN("This op code is existed");
        return -2;
    }

    memset(&callback, 0, sizeof(cmd_cb_t));
    callback.op_code = op_code;
    callback.proc_req = req_cb;
    callback.proc_rsp = rsp_cb;

    memcpy(&m_cb_list[count], &callback, sizeof(cmd_cb_t));

    return 0;
}

/**@brief Handler for waiting response timeout */
static void tmr_rsp_timeout_handler(struct k_timer* timer)
{
    LOG_DBG("%s", __func__);

    uint32_t  err_code;
    app_cmd_t cmd;
    cmd_cb_t  cmd_cb;
    cmd_event_t event;

    err_code = buff_to_cmd(&m_tx_buff, &cmd);
    if (err_code != 0) {
        LOG_ERR("Buffer error");
        return;
    }

    err_code = cmd_cb_get(cmd.op_code, &cmd_cb);
    if (err_code == 0) {
        uint8_t p_rsp[] = CMD_RSP_TIMEOUT;

        if (cmd_cb.proc_rsp) {
            cmd_cb.proc_rsp(p_rsp, sizeof(p_rsp));
        }

        event.op_code = cmd.op_code;
        event.p_data = p_rsp;
        event.length = sizeof(p_rsp);
        event.timeout = true;

        m_event_cb(&event);
    }
    else {
        // Should not come here
        LOG_ERR("op is unregisterd(wait rsp)");
    }

    state_set(&m_cmd_ctx, CMD_STATE_IDLE);
}

/**@brief Handler for processing request */
static void wk_proc_req_handler(struct k_work* unused)
{
    LOG_DBG("%s", __func__);

    int err_code;
    app_cmd_t cmd;
    cmd_cb_t  cmd_cb;
    cmd_event_t event;

    err_code = buff_to_cmd(&m_rx_buff, &cmd);
    if (err_code != 0) {
        LOG_ERR("Buffer error");
        return;
    }

    err_code = cmd_cb_get(cmd.op_code, &cmd_cb);
    if (err_code == 0) {
        if (cmd_cb.proc_req) {
            cmd_cb.proc_req(cmd.p_data, cmd.length, app_cmd_respond);
        }
        else {
            app_cmd_respond(NULL, 0);
        }

        event.op_code = cmd.op_code;
        event.p_data = cmd.p_data;
        event.length = cmd.length;
        event.timeout = false;

        m_event_cb(&event);
    }
    else {
        LOG_ERR("op is unregisterd(proc req)");
        uint8_t p_rsp[] = CMD_RSP_UNREG;

        app_cmd_respond(p_rsp, sizeof(p_rsp));
    }
}

/**@brief Handler for processing response */
static void wk_proc_rsp_handler(struct k_work* unused)
{
    LOG_DBG("%s", __func__);

    int err_code;
    app_cmd_t cmd;
    cmd_cb_t  cmd_cb;
    cmd_event_t event;

    state_set(&m_cmd_ctx, CMD_STATE_IDLE);

    err_code = buff_to_cmd(&m_rx_buff, &cmd);
    if (err_code != 0) {
        LOG_ERR("Buffer error");
        return;
    }

    err_code = cmd_cb_get(cmd.op_code, &cmd_cb);
    if (err_code == 0) {
        if (cmd_cb.proc_rsp) {
            cmd_cb.proc_rsp(cmd.p_data, cmd.length);
        }

        event.op_code = cmd.op_code;
        event.p_data = cmd.p_data;
        event.length = cmd.length;
        event.timeout = false;

        m_event_cb(&event);
    }
    else {
        // Should not come here
        LOG_ERR("op is unregisterd(proc rsp): %d", cmd.op_code);
    }
}

/**@brief Get cmd length from cmd data buffer
 *
 * @param[in] p_buff: pointer of cmd data buffer
 *
 * @return 0: not found
 *         others: cmd length
 */
static uint16_t cmd_len_get(buffer_t* p_buff)
{
    uint8_t* p_data;
    uint16_t cmd_len;


    cmd_len = 0;
    p_data = p_buff->p_data;

    if (p_buff->length > CMD_FMT_SIZE_START + CMD_FMT_SIZE_LEN) {
        cmd_len = CMD_FMT_OFFSET_OPCODE + CMD_FMT_SIZE_CRC + uint16_decode(&p_data[CMD_FMT_OFFSET_LEN]);
    }

    return cmd_len;
}

/**@brief Validate format of a cmd
 *
 * @param[in] p_buff: pointer of cmd data buffer
 * @param[in] op_code: op code of the request in host mode,
 *  in slave mode, it's not used
 *
 * @return 0: format is ok
 *         -1: format is wrong
 */
static int format_check(buffer_t* p_buff, uint8_t op_code, cmd_mode_t mode)
{
    uint16_t cmd_len;
    uint16_t cmd_crc;
    bool crc_ok;

    uint8_t* p_data = p_buff->p_data;
    uint16_t length = p_buff->length;

    // Check start flag
    if (mode == CMD_MODE_HOST &&
        p_data[CMD_FMT_OFFSET_START] != CMD_FMT_START_RSP) {
        LOG_ERR("Invalid cmd format: start(host)");
        return -1;
    }
    else if (mode == CMD_MODE_SLAVE &&
        p_data[CMD_FMT_OFFSET_START] != CMD_FMT_START_REQ) {
        LOG_ERR("Invalid cmd format: start(slave)");
        return -1;
    }

    // Check length
    cmd_len = uint16_decode(&p_data[CMD_FMT_OFFSET_LEN]) +
        CMD_FMT_OFFSET_OPCODE + CMD_FMT_SIZE_CRC;
    if (length != cmd_len) {
        LOG_ERR("Invalid cmd format: length");
        return -1;
    }

    // Check op code
    if (mode == CMD_MODE_HOST &&
        p_data[CMD_FMT_OFFSET_OPCODE] != op_code) {
        LOG_ERR("Invalid cmd format: op code");
        return -1;
    }

    // Check CRC
    cmd_crc = uint16_decode(&p_data[cmd_len - CMD_FMT_SIZE_CRC]);
    crc_ok = crc16_check(&p_data[CMD_FMT_OFFSET_LEN],
        cmd_len - CMD_FMT_SIZE_START - CMD_FMT_SIZE_CRC,
        cmd_crc);
    if (!crc_ok) {
        LOG_ERR("Invalid cmd format: crc");
        return -1;
    }

    return 0;
}
/**@brief Get op code from a cmd data buffer */
static int op_code_get(buffer_t* p_buff, uint8_t* op_code)
{
    if (p_buff == NULL || p_buff->p_data == NULL) {
        return -1;
    }

    // Assume it's a valid buffer, so skip format check
    *op_code = p_buff->p_data[CMD_FMT_OFFSET_OPCODE];

    return 0;
}

/**@brief Build a data buffer from a cmd structure
 *
 * @note It will allocate memory for buffer
 *
 * @param[in] p_cmd: pointer of cmd
 * @param[out] p_buff: cmd data buffer
 *
 * @return 0: ok
 */
static int cmd_to_buff(app_cmd_t* p_cmd, buffer_t* p_buff)
{
    __ASSERT_NO_MSG(p_cmd != NULL);

    uint16_t crc16;
    uint16_t pdu_len;
    uint8_t* p_packet;
    uint16_t pkt_len;

    buff_alloc(m_tx_pool, p_buff);

    p_packet = p_buff->p_data;
    pdu_len = p_cmd->length;

    /* Start flag */
    p_packet[CMD_FMT_OFFSET_START] =
        (p_cmd->type == CMD_TYPE_RESPONSE) ?
        CMD_FMT_START_RSP :
        CMD_FMT_START_REQ;

    /* Length */
    uint16_encode(CMD_FMT_SIZE_OPCODE + pdu_len,
        &p_packet[CMD_FMT_OFFSET_LEN]);

    /* OP code */
    p_packet[CMD_FMT_OFFSET_OPCODE] = p_cmd->op_code;

    /* PDU */
    if (pdu_len > 0 && p_cmd->p_data != NULL) {
        memcpy(&p_packet[CMD_FMT_OFFSET_PDU], p_cmd->p_data, pdu_len);
    }

    /* CRC: crc16 init value must be 0 */
    crc16 = crc16_compute(&p_packet[CMD_FMT_OFFSET_LEN],
        CMD_FMT_SIZE_LEN + CMD_FMT_SIZE_OPCODE + pdu_len);
    uint16_encode(crc16, &p_packet[CMD_FMT_OFFSET_PDU + pdu_len]);

    /* Packet length */
    pkt_len = CMD_FMT_OFFSET_PDU + pdu_len + CMD_FMT_SIZE_CRC;
    pkt_len = MIN(pkt_len, CMD_PACKET_LENGTH);

    p_buff->length = pkt_len;

    return 0;
}

/**@brief Get a cmd from a data buff 
 * 
 * @param[in] p_buff: cmd data buffer
 * @param[out] p_cmd: pointer of cmd
 *
 * @return 0: ok
 *         -1: pointer is NULL
 */
static int buff_to_cmd(buffer_t* p_buff, app_cmd_t* p_cmd)
{
    if (p_buff->p_data == NULL || p_cmd == NULL) {
        return -1;
    }

    uint8_t* p_data;
    uint16_t op_pdu_len;

    p_data = p_buff->p_data;
    op_pdu_len = uint16_decode(&p_data[CMD_FMT_OFFSET_LEN]);

    p_cmd->type = p_data[CMD_FMT_OFFSET_START];
    p_cmd->op_code = p_data[CMD_FMT_OFFSET_OPCODE];
    p_cmd->length = op_pdu_len - CMD_FMT_SIZE_OPCODE;
    p_cmd->p_data = &p_data[CMD_FMT_OFFSET_PDU];

    return 0;
}

/**@brief Send a cmd by UART */
static int cmd_send(app_cmd_t* p_cmd)
{
    on_cmd_send_start();

    cmd_to_buff(p_cmd, &m_tx_buff);
    return app_uart_send(m_tx_buff.p_data, m_tx_buff.length);
}

/**@brief Send a response */
static int app_cmd_respond(uint8_t* p_data, uint16_t length)
{
    int err_code;
    uint8_t  op_code;
    app_cmd_t cmd;

    if (state_get(&m_cmd_ctx) != CMD_STATE_REQ_RECEIVED &&
        state_get(&m_cmd_ctx) != CMD_STATE_REQ_SENT) {
        LOG_ERR("Invalid state for response:%d", state_get(&m_cmd_ctx));
        return -1;
    }

    err_code = op_code_get(&m_rx_buff, &op_code);
    if (err_code != 0) {
        LOG_ERR("rx buffer is reset too early");
        on_cmd_send_error();
        return err_code;
    }

    cmd.type = CMD_TYPE_RESPONSE;
    cmd.op_code = op_code;
    cmd.p_data = p_data;
    cmd.length = length;

    return cmd_send(&cmd);
}

/**@brief Send a request cmd
 *
 * @param[in] op_code: cmd op code
 * @param[in] p_data: pointer of cmd data
 * @param[in] length: length of cmd data
 *
 * @return 0: success
 * @return -1: error
 */
uint32_t app_cmd_request(uint8_t op_code, uint8_t* p_data, uint16_t length)
{
    if (mode_get(&m_cmd_ctx) != CMD_MODE_IDLE) {
        LOG_ERR("%s, exit with %d", __func__, m_cmd_ctx.mode);
        return -1;
    }

    app_cmd_t cmd =
    {
        .type = CMD_TYPE_REQUEST,
        .op_code = op_code,
        .p_data = p_data,
        .length = length,
    };

    mode_set(&m_cmd_ctx, CMD_MODE_HOST);

    return cmd_send(&cmd);
}

/**@brief Register a callback for request and response
 *
 * @note This functions is duplicated to callback functions
 * (req_proc, rsp_proc), but it's useful 
 *
 * @todo Check to remove rsp_proc
 */
void app_cmd_event_cb_register(cmd_event_cb_t event_cb)
{
    if (event_cb != NULL) {
        m_event_cb = event_cb;
    }
}

/**@brief Handler for UART tx complete */
static void on_uart_tx_empty(int event)
{
    LOG_DBG("%s", __func__);
    if (event == 0) {
        on_cmd_send_complete();
    }
    else {
        on_cmd_send_error();
    }
}

/**@brief Handler for UART rx data ready */
static void on_uart_rx_ready(uint8_t* p_data, uint16_t length)
{
    int err_code;
    uint8_t  req_op_code;
    static bool rx_started; //false init
    static uint16_t cmd_len;
    //LOG_WRN("%s, length=%d", __func__, length);

    if (mode_get(&m_cmd_ctx) == CMD_MODE_HOST) {
        if (m_cmd_ctx.state != CMD_STATE_REQ_SENT &&
            m_cmd_ctx.state != CMD_STATE_RSP_RECEIVING) {
            LOG_WRN("Invalid state for rx(host)");
            return;
        }
    }

    if (mode_get(&m_cmd_ctx) == CMD_MODE_SLAVE) {
        if (m_cmd_ctx.state != CMD_STATE_REQ_RECEIVING) {
            LOG_WRN("Invalid state for rx(slave)");
            return;
        }
    }

    LOG_INF("Length Rec: %hd",length);

    if (!rx_started) {
        rx_started = true;
        buff_alloc(m_rx_pool, &m_rx_buff);
        memcpy(m_rx_buff.p_data, p_data, length);
        m_rx_buff.length = length;
        cmd_len = 0;
        on_cmd_receive_start();
    }else{
        m_rx_buff.length += length;
    }

    if (cmd_len == 0) {

        cmd_len = cmd_len_get(&m_rx_buff);

        if (cmd_len > CMD_PACKET_LENGTH) {
            LOG_ERR("CMD_Len Larger than Packet Length %d",cmd_len);
            on_cmd_receive_error();
        }

        if (cmd_len == 0) {
            return;
        }
    }

    if (m_rx_buff.length < cmd_len) {
        return;
    }

    //LOG_HEXDUMP_DBG(m_rx_buff.p_data, m_rx_buff.length, "RX");

    req_op_code = 0;
    if (mode_get(&m_cmd_ctx) == CMD_MODE_HOST) {
        op_code_get(&m_tx_buff, &req_op_code);
    }
    err_code = format_check(&m_rx_buff, req_op_code, mode_get(&m_cmd_ctx));

    if (err_code == 0) {
        on_cmd_receive_complete();
    }
    // Invalid format
    else if (err_code == -1) {
        LOG_ERR("Command has Invald Format");
        on_cmd_receive_error();
    }
    // On going receiving
    else {
        LOG_ERR("Should not come here(%d)", err_code);
        on_cmd_receive_error();
    }

    rx_started = false;
}

/**@brief Initialize app cmd module
 *
 * @param[in] p_device: pointer of UART device
 * @param[in] evt_cb: callback of cmd event
 *
 * @return 0: success
 * @return neg: error
 */
int app_cmd_init(struct device* p_device)
{
    int rc;
    static bool initialized = false;

    rc = app_uart_init(p_device, m_rx_pool, CMD_PACKET_LENGTH);
    if (rc != 0) {
        LOG_ERR("UART device init failed");
        return -ENXIO;
    }

    state_set(&m_cmd_ctx, CMD_STATE_IDLE);

    memset(&m_cmd_ctx.cmd, 0, sizeof(app_cmd_t));

    memset(&m_rx_pool, 0, sizeof(m_rx_pool));
    memset(&m_tx_pool, 0, sizeof(m_tx_pool));
    memset(&m_rx_buff, 0, sizeof(buffer_t));
    memset(&m_tx_buff, 0, sizeof(buffer_t));

    app_uart_rx_cb_set(on_uart_rx_ready);
    app_uart_tx_cb_set(on_uart_tx_empty);

    if (!initialized) {
        initialized = true;

        m_event_cb = event_cb_dummy;

        memset(&m_cb_list, 0, sizeof(m_cb_list));

        k_work_init(&wk_proc_req, wk_proc_req_handler);
        k_work_init(&wk_proc_rsp, wk_proc_rsp_handler);

        app_cmd_add(CMD_OP_PING, req_cb_ping, rsp_cb_ping);
        app_cmd_add(CMD_OP_RAW_DATA, req_cb_raw_data, rsp_cb_raw_data);
    }

    return 0;
}

/**@brief Un-initialize app cmd module */
void app_cmd_uninit(void)
{
    app_uart_uninit();

    k_timer_stop(&tmr_wait_rsp);
}

/**@brief Callback function for ping request. */
static int req_cb_ping(uint8_t* p_req, uint16_t req_len, cmd_respond_t respond)
{
    LOG_INF("%s", __func__);

    char* rsp = "ok";
    respond(rsp, strlen(rsp));

    return 0;
}

/**@brief Callback function for ping response. */
static void rsp_cb_ping(uint8_t* p_rsp, uint16_t rsp_len)
{
    LOG_INF("%s", __func__);
}

/**@brief Callback function for raw_data request. */
static int req_cb_raw_data(uint8_t* p_req, uint16_t req_len, cmd_respond_t respond)
{
    LOG_DBG("%s", __func__);
    char* rsp = "ok";

    // TODO: fill user function to handle raw data
    if (req_len > 0) {
        LOG_HEXDUMP_INF(p_req, MIN(req_len, 8), "raw data:");
    }

    respond(rsp, strlen(rsp));

    return 0;
}

/**@brief Callback function for mtu_get response. */
static void rsp_cb_raw_data(uint8_t* p_rsp, uint16_t rsp_len)
{
    LOG_DBG("%s", __func__);

    if (rsp_len > 0) {
        LOG_HEXDUMP_INF(p_rsp, MIN(rsp_len, 8), "raw data:");
    }
}

/**@brief Send a ping request */
void cmd_request_ping(void)
{
    app_cmd_request(CMD_OP_PING, "yq", 2);
}

/**@brief Send a raw data request */
void cmd_request_raw_data(uint8_t* p_data, uint16_t length)
{
    app_cmd_request(CMD_OP_RAW_DATA, p_data, length);
}
```

## src/app_flash.c
```c
#include <zephyr.h>
#include <device.h>
#include <drivers/flash.h>
#include <storage/flash_map.h>
#include <sys/crc.h>
#include <sys/byteorder.h>
#include <sys/util.h>
#include <logging/log.h>
LOG_MODULE_REGISTER(app_flash, 3);

#include "app_flash.h"

/**@brief Get flash info
 *
 * @details Info structure: bank start address[4], page
 * count of the bank[4], the first blank page[4].
 * The first blank page is used to implement resume
 * from the break point.
 *
 * @return 0: success
 * @return neg: error
 */
int app_flash_si_slotinfo(uint8_t* p_data)
{
	int rc;
	const struct flash_area* fa;
	uint32_t bank_addr;
	uint32_t page_count;
	uint32_t first_blank;

	uint32_t p_read;
	bool  found;

	rc = flash_area_open(APP_FLASH_BANK_ID, &fa);
	if (rc) {
		return rc;
	}

	bank_addr = fa->fa_off;
	page_count = fa->fa_size / 0x1000;

	flash_area_close(fa);

	found = false;
	p_read = bank_addr;
	while (p_read < fa->fa_size) {
		for (uint32_t i = 0; i < 4096; i++) {
			if (((uint8_t*)p_read)[i] != 0xFF) {
				found = true;
				break;
			}
		}

		if (!found) {
			break;
		}

		p_read += 4096;
	}

	first_blank = MAX(bank_addr, (p_read - 4096));

	sys_put_le32(bank_addr, &p_data[0]);
	sys_put_le32(page_count, &p_data[4]);
	sys_put_le32(first_blank, &p_data[8]);

	return rc;
}

/**@brief Read flash data
 *
 * @param[in] offset: offset from the bank start
 * @param[out] p_data: pointer of data
 * @param[in] length: length of data to be read
 *
 * @return 0: success
 * @return neg: error
 */
int app_flash_read(uint32_t offset, uint8_t* p_data, uint32_t length)
{
	int rc;
	const struct flash_area* fa;

	rc = flash_area_open(APP_FLASH_BANK_ID, &fa);
	if (rc) {
		return rc;
	}

    // TODO: here should check the boundary of flash

	rc = flash_area_read(fa, offset, p_data, length);
	if (rc) {
		return rc;
	}

	flash_area_close(fa);

	return rc;
}

/**@brief Read flash data with Bank ID
 *
 * @param[in] offset: offset from the bank start
 * @param[out] p_data: pointer of data
 * @param[in] length: length of data to be read
 * @param[in] FLASH_ID: ID of Flash to be read
 * 
 * @return 0: success
 * @return neg: error
 */
int app_flash_read_id(uint32_t offset, uint8_t* p_data, uint32_t length,uint8_t FLASH_ID)
{
	int rc;
	const struct flash_area* fa;

	rc = flash_area_open(FLASH_ID, &fa);
	if (rc) {
		return rc;
	}

    // TODO: here should check the boundary of flash

	rc = flash_area_read(fa, offset, p_data, length);
	if (rc) {
		return rc;
	}

	flash_area_close(fa);

	return rc;
}
/**@brief Get Available Space for MCUBOOTSECONDARY Slot in Bytes
 *
 * @return >= 0: success
 * @return neg: error
 */
static uint32_t app_flash_get_availablesize(){

	int rc;
	const struct flash_area* fa;
	uint32_t size;

	rc = flash_area_open(APP_FLASH_BANK_ID, &fa);
	if (rc) {
		return rc;
	}

	size = fa->fa_size;

	flash_area_close(fa);

	return size;
}

//Get Fw Num
static int app_flash_fwnum(uint8_t* minor_fw, uint8_t* major_fw)
{
	int rc;
	
	uint8_t Data_bata[2];

	rc = app_flash_read_id(20,Data_bata,2,FLASH_AREA_ID(image_0));//4+4+2+2+4+4 20 21

	*minor_fw=Data_bata[0];
	*major_fw=Data_bata[1];

	return rc;
}

int app_flash_get_DevInf(uint8_t* buffer,uint16_t bufferlength){
	int rc = 0;
	
	if(bufferlength < 6){ //6 -> major minor version = 2 Byte + 4 byte for Available Space
		return -1;
	}

	//Retrieve FW Version
	rc = app_flash_fwnum(&buffer[0],&buffer[1]);
	sys_put_le32(app_flash_get_availablesize(),&buffer[2]);

	return rc;
}


/**@brief Write flash data
 *
 * @details If length is not word aligned, it will fill
 * 0xFF as end padding
 *
 * @param[in] offset: offset from the bank start
 * @param[in] p_data: pointer of data
 * @param[in] length: length of data to be read
 *
 * @return 0: success
 * @return neg: error
 */
int app_flash_write(uint32_t offset, uint8_t* p_data, uint32_t length)
{
	int rc;
	const struct flash_area* fa;
	uint8_t  p_last_word[4] = {0xFF, 0xFF, 0xFF, 0xFF};
	uint32_t word_align_len;

	rc = flash_area_open(APP_FLASH_BANK_ID, &fa);
	if (rc) {
		return rc;
	}

	if (length % 4 != 0) {
		word_align_len = length / 4 * 4;
	}
	else {
		word_align_len = length;
	}

	rc = flash_area_write(fa, offset, p_data, word_align_len);
	if (rc != 0) {
		return rc;
	}

	if (word_align_len < length) {
		memcpy(p_last_word, &p_data[word_align_len], (length - word_align_len));
		rc = flash_area_write(fa, offset + word_align_len, p_last_word, 4);
		if (rc) {
			return rc;
		}
	}

	flash_area_close(fa);

	return rc;
}

/**@brief Erase flash pages
 *
 * @param[in] offset: offset from the bank start
 * @param[in] count: page count to be erased
 *
 * @return 0: success
 * @return neg: error
 */
int app_flash_erase_page(uint32_t offset, uint32_t count)
{
	int rc;
	const struct flash_area* fa;
	uint32_t byte_len;

	rc = flash_area_open(APP_FLASH_BANK_ID, &fa);
	if (rc) {
		return rc;
	}

	byte_len = MIN(count * 0x1000, fa->fa_size);

	rc = flash_area_erase(fa, offset, byte_len);

	flash_area_close(fa);

	return rc;
}

/**@brief Erase flash pages from the bank end
 *
 * @param[in] offset: offset from the bank start
 * @param[in] count: page count to be erased
 *
 * @return 0: success
 * @return neg: error
 */
int app_flash_erase_from_end(uint32_t count)
{
	int rc;
	const struct flash_area* fa;
	uint32_t byte_len;
    uint32_t offset;

	rc = flash_area_open(APP_FLASH_BANK_ID, &fa);
	if (rc) {
		return rc;
	}

	byte_len = MIN(count * 0x1000, fa->fa_size);
    offset = fa->fa_size - byte_len;

	rc = flash_area_erase(fa, offset, byte_len);

	flash_area_close(fa);

	return rc;
}

/**@brief Get crc value of flash data
 *
 * @param[in] offset: offset from the bank start
 * @param[in] length: length of data to be read
 * @param[out] crc32: pointer of crc value
 *
 * @return 0: success
 * @return neg: error
 */
int app_flash_crc(uint32_t offset, uint32_t length, uint32_t* crc32)
{
	int rc;
	const struct flash_area* fa;
	uint8_t *bank_addr;
	uint32_t step = 1024;
	uint32_t crc_val = 0;
	uint32_t i;

	rc = flash_area_open(APP_FLASH_BANK_ID, &fa);
	if (rc) {
		return rc;
	}

	bank_addr = (uint8_t *)(fa->fa_off);

	if (length <= step) {
		crc_val = crc32_ieee(bank_addr, length);
	}
	else {
		crc_val = 0;

		for (i = 0; i < length / step; i++) {
			crc_val = crc32_ieee_update(crc_val, bank_addr + i * step, step);
		}
		if (length % step != 0) {
			crc_val = crc32_ieee_update(crc_val, bank_addr + i * step, length % step);
		}
	}
	*crc32 = crc_val;

	flash_area_close(fa);

	return rc;
}
```

## src/app_flash_cmd.c
```c
#include <zephyr.h>
#include <device.h>
#include <sys/byteorder.h>
#include <logging/log.h>
LOG_MODULE_REGISTER(cmd_flash, 3);

#include "app_cmd.h"
#include "app_flash.h"
#include "app_flash_cmd.h"

/*---------------------------------------------------------------------------------*/
//Requests
/*---------------------------------------------------------------------------------*/

/**@brief Callback of flash info request
 *
 * @details Request: none.
 * Response: {bank address[4], page count of the bank[4],
 * first blank page[4]} or none
 *
 * @param[in] p_req     Pointer of request data
 * @param[in] req_len   Length of request data
 * @param[in] respond   Callback function of responding
 *
 * @return 0 success
 * @return neg error
 */
static int req_cb_flash_info(uint8_t* p_req, uint16_t req_len, cmd_respond_t respond)
{
    LOG_DBG("%s", __func__);

    int   rc;
    uint8_t  p_rsp[12];
    uint16_t rsp_len = 12;

    rc = app_flash_si_slotinfo(p_rsp);

    LOG_DBG("add: %08x, cnt: %d, first: %x", \
            sys_get_le32(&p_rsp[0]),         \
            sys_get_le32(&p_rsp[4]),         \
            sys_get_le32(&p_rsp[8]));

    if (rc == 0) {
        respond(p_rsp, rsp_len);
    }
    else {
        respond(NULL, 0);
    }

    return rc;
}

/**@brief Callback of flash read request
 *
 * @details Request: address offset[4], data length[4]
 * Response: read data or none
 *
 * @param[in] p_req     Pointer of request data
 * @param[in] req_len   Length of request data
 * @param[in] respond   Callback function of responding
 *
 * @return 0 success
 * @return neg error
 */
static int req_cb_flash_read(uint8_t* p_req, uint16_t req_len, cmd_respond_t respond)
{
    LOG_DBG("%s", __func__);

    int   rc;
    uint8_t* p_rsp;
    uint16_t rsp_len;

    uint32_t offset = sys_get_le32(&p_req[0]);
    uint32_t length = sys_get_le32(&p_req[4]);

    LOG_INF("read offset: %x, length: %d", offset, length);

    rsp_len = length;

    p_rsp = k_malloc(rsp_len);

    if (p_rsp != NULL) {
        rc = app_flash_read(offset, p_rsp, length);
        if (rc == 0) {
            respond(p_rsp, rsp_len);
            k_free(p_rsp);
        }
        else {
            respond(NULL, 0);
        }
    }
    else {
        rc = -1;
        respond(NULL, 0);
    }

    return rc;
}

/**@brief Callback of flash write request
 *
 * @details Request: address offset[4], data length[4],
 * data[N]. Response: "ok" or none
 *
 * @param[in] p_req     Pointer of request data
 * @param[in] req_len   Length of request data
 * @param[in] respond   Callback function of responding
 *
 * @return 0 success
 * @return neg error
 */
static int req_cb_flash_write(uint8_t* p_req, uint16_t req_len, cmd_respond_t respond)
{
    LOG_DBG("%s", __func__);

    int rc = 0;

    uint32_t offset = sys_get_le32(&p_req[0]);
    uint32_t length = sys_get_le32(&p_req[4]);
    uint8_t* p_data = &p_req[8];

    LOG_INF("write offset: %x, length: %d", offset, length);

    rc = app_flash_write(offset, p_data, length);
    if (rc == 0) {
        respond("ok", 2);
    }
    else {
        respond(NULL, 0);
    }

    return rc;
}

/**@brief Callback of flash erase request
 *
 * @details Request: address offset[4], page count[4]
 * Response: "ok" or none
 *
 * @param[in] p_req     Pointer of request data
 * @param[in] req_len   Length of request data
 * @param[in] respond   Callback function of responding
 *
 * @return 0 success
 * @return neg error
 */
static int req_cb_flash_erase(uint8_t* p_req, uint16_t req_len, cmd_respond_t respond)
{
    LOG_DBG("%s", __func__);

    int rc;
    uint32_t offset = sys_get_le32(&p_req[0]);
    uint32_t count = sys_get_le32(&p_req[4]);

    rc = app_flash_erase_page(offset, count);
    if (rc == 0) {
        respond("ok", 2);
    }
    else {
        respond(NULL, 0);
    }

    LOG_INF("erase offset: %x, count: %d", offset, count);

    return rc;
}

/**@brief Callback of flash crc request
 *
 * @details Request: address offset[4], data length[4]
 * Response: crc32[4] or none
 *
 * @param[in] p_req     Pointer of request data
 * @param[in] req_len   Length of request data
 * @param[in] respond   Callback function of responding
 *
 * @return 0 success
 * @return neg error
 */
static int req_cb_flash_crc(uint8_t* p_req, uint16_t req_len, cmd_respond_t respond)
{
    LOG_DBG("%s", __func__);

    int rc;
    uint8_t  p_rsp[4];
    uint16_t rsp_len = 4;

    uint32_t crc32;
    uint32_t offset = sys_get_le32(&p_req[0]);
    uint32_t length = sys_get_le32(&p_req[4]);

    LOG_INF("crc offset: %x, length: %d", offset, length);

    rc = app_flash_crc(offset, length, &crc32);
    if (rc == 0) {
        sys_put_le32(crc32, p_rsp);
        respond(p_rsp, rsp_len);
    }
    else {
        respond(NULL, 0);
    }

    return rc;
}

/**@brief Callback of flash start request
 *
 * @details Request: none
 * Response: "ok"
 *
 * @param[in] p_req     Pointer of request data
 * @param[in] req_len   Length of request data
 * @param[in] respond   Callback function of responding
 *
 * @return 0 success
 * @return neg error
 */
static int req_cb_flash_start(uint8_t* p_req, uint16_t req_len, cmd_respond_t respond)
{
    LOG_DBG("%s", __func__);

    respond("ok", 2);

    return 0;
}

/**@brief Callback of flash done request
 *
 * @details Request: none
 * Response: "ok"
 *
 * @param[in] p_req     Pointer of request data
 * @param[in] req_len   Length of request data
 * @param[in] respond   Callback function of responding
 *
 * @return 0 success
 * @return neg error
 */
static int req_cb_flash_done(uint8_t* p_req, uint16_t req_len, cmd_respond_t respond){
    LOG_DBG("%s", __func__);

    respond("ok", 2);

    return 0;
}

/**@brief Register flash related commands
 *
 * @param cb: event callback function
 */
void app_flash_cmd_init(void)
{
    app_cmd_add(CMD_OP_FLASH_INFO_52,  req_cb_flash_info,NULL);
    app_cmd_add(CMD_OP_FLASH_WRITE_52, req_cb_flash_write, NULL);
    app_cmd_add(CMD_OP_FLASH_ERASE_52, req_cb_flash_erase, NULL);
    app_cmd_add(CMD_OP_FLASH_DONE_52, req_cb_flash_done, NULL);

    app_cmd_add(CMD_OP_FLASH_READ_52,  req_cb_flash_read, NULL);
    app_cmd_add(CMD_OP_FLASH_CRC_52,   req_cb_flash_crc, NULL);
    app_cmd_add(CMD_OP_FLASH_START_52, req_cb_flash_start, NULL);

}
```

## src/app_flash_cmd.h
```c
#ifndef APP_FLASH_CMD_H__
#define APP_FLASH_CMD_H__

#include <zephyr.h>
#include "app_cmd.h"

#ifdef __cplusplus
extern "C" {
#endif

// app flash commands: 0x20 - 0x2F
#define CMD_OP_FLASH_52        0x20
#define CMD_OP_FLASH_INFO_52   (CMD_OP_FLASH_52 + 1)
#define CMD_OP_FLASH_READ_52   (CMD_OP_FLASH_52 + 2)
#define CMD_OP_FLASH_WRITE_52  (CMD_OP_FLASH_52 + 3)
#define CMD_OP_FLASH_ERASE_52  (CMD_OP_FLASH_52 + 4)
#define CMD_OP_FLASH_CRC_52    (CMD_OP_FLASH_52 + 5)
#define CMD_OP_FLASH_START_52  (CMD_OP_FLASH_52 + 6)
#define CMD_OP_FLASH_DONE_52   (CMD_OP_FLASH_52 + 7)
	
// app flash commands 91: 0x30 - 0x2F#
#define CMD_OP_FLASH_91        0x30
#define CMD_OP_FLASH_INFO_91   (CMD_OP_FLASH_91 + 1)
#define CMD_OP_FLASH_READ_91   (CMD_OP_FLASH_91 + 2)
#define CMD_OP_FLASH_WRITE_91  (CMD_OP_FLASH_91 + 3)
#define CMD_OP_FLASH_ERASE_91  (CMD_OP_FLASH_91 + 4)
#define CMD_OP_FLASH_CRC_91    (CMD_OP_FLASH_91 + 5)
#define CMD_OP_FLASH_START_91  (CMD_OP_FLASH_91 + 6)
#define CMD_OP_FLASH_DONE_91   (CMD_OP_FLASH_91 + 7)

typedef struct{
    rsp_cb_t rsp_cb_info;
    rsp_cb_t rsp_cb_write;
    rsp_cb_t rsp_cb_erase;
    rsp_cb_t rsp_cb_done;

}rsp_cb_struc_t;


/**@brief Register flash related commands
 *
 * @param cb: event callback
 */
void app_flash_cmd_init(void);

#ifdef __cplusplus
}
#endif

#endif /* APP_FLASH_CMD_H__ */
```

## src/app_uart.h
```c
#ifndef APP_UART_H__
#define APP_UART_H__

#include <zephyr.h>

#ifdef __cplusplus
extern "C" {
#endif

/** @typedef uart buffer type */
typedef struct
{
    uint8_t*       p_data;					/* Pointer of data */
    uint16_t 	length;					/* Data length of the buffer */
    uint16_t 	max_len;				/* Max of data length */
} uart_buff_t;

/**@typedef uart receiving callback function type
 *
 * @param[in] p_buffer 	pointer of data buffer
 * @param[in] length 	data length
 */
typedef void (*uart_rx_cb)(uint8_t* p_data, uint16_t length);

/**@typedef uart sending callback function type 
 *
 * @param[in] event     tx event id. 0: success, -1: failed.
 */
typedef void (*uart_tx_cb)(int event);

/**@brief Initialize app_uart module
 *
 * @param[in] p_device 		pointer of UART device
 * @param[in] p_rx_buff		pointer of UART rx buffer
 * @param[in] rx_max_len	max length of rx buffer
 *
 * @return 0				success
 * @return -1				failed
 */
int app_uart_init(struct device* p_device, uint8_t* p_rx_buff,
		uint16_t rx_max_len);

/**@brief Un-initialize app_uart module */
void app_uart_uninit(void);

/**@brief Send uart data
 *
 * @param p_data		pointer of data to be sent
 * @param length		length of data to be sent
 *
 * @return 0			success
 * @return -1			failed
 */
int app_uart_send(const uint8_t* p_data, uint16_t length);

/**@brief Rest a buffer data
 *
 * @param[in] p_buff: pointer of the buffer
 *
 * @return n/a
 */
void uart_buffer_reset(uart_buff_t* p_buff);

/**@brief Reset rx buffer */
void app_uart_rx_reset(void);

/**@brief Set rx data ready event callback */
void app_uart_rx_cb_set(uart_rx_cb cb);

/**@brief Set tx empty event callback */
void app_uart_tx_cb_set(uart_tx_cb cb);


#ifdef __cplusplus
}
#endif

#endif /* APP_UART_H__ */
```

## src/ble_dfu_helper.h
```c
#ifndef DFU_HELPER_H__
#define DFU_HELPER_H__

#include <stdint.h>
#include "../libs/app_flash_cmd.h"
#include "src/blecmds.h"

#ifdef __cplusplus
extern "C" {
#endif




void dfu_file_ready(uint8_t m_image_channel);

void module_init(void);

void nus_received_cb_handler(struct bt_conn *conn, const uint8_t *const p_write_data,uint16_t write_data_len);

uint32_t ble_send_req(uint8_t req);

uint32_t ble_send_req_conn(const struct bt_conn *conn,uint8_t req);

void self_update(void);

void self_info(void);

uint32_t cmd_request_flash_info(void);
uint32_t cmd_request_flash_write(uint8_t* p_data, uint16_t length);
uint32_t cmd_request_flash_read(uint32_t address, uint16_t length);
uint32_t cmd_request_flash_erase(uint32_t address, uint16_t count);
uint32_t cmd_request_flash_done(void);

#ifdef __cplusplus
}
#endif

#endif /* DFU_HELPER_H__ */
```
