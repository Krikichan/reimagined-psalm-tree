## bchip/build/Kconfig/Kconfig.shield.defconfig
```kconfig
osource "c:/ncs/v1.9.1/zephyr/boards/boards/shields/*/Kconfig.defconfig"
osource "c:/ncs/v1.9.1/nrf/boards/arm/boards/shields/*/Kconfig.defconfig"
osource "c:/ncs/v1.9.1/zephyr/boards/arm/nrf52840dk_nrf52840/boards/shields/*/Kconfig.defconfig"
osource "c:/ncs/v1.9.1/zephyr/boards/arm/nrf9160dk_nrf9160/boards/shields/*/Kconfig.defconfig"
osource "c:/apoplexmed/Appli/fuckinguart/boards/shields/*/Kconfig.defconfig"
osource "C:/ncs/v1.9.1/nrf/boards/shields/*/Kconfig.defconfig"
```

## simp/build/Kconfig/Kconfig.shield
```kconfig
osource "c:/ncs/v1.9.1/zephyr/boards/boards/shields/*/Kconfig.shield"
osource "c:/ncs/v1.9.1/nrf/boards/arm/boards/shields/*/Kconfig.shield"
osource "c:/ncs/v1.9.1/zephyr/boards/arm/nrf52840dk_nrf52840/boards/shields/*/Kconfig.shield"
osource "c:/ncs/v1.9.1/zephyr/boards/arm/nrf9160dk_nrf9160/boards/shields/*/Kconfig.shield"
osource "c:/apoplexmed/Appli/fuckinguart/boards/shields/*/Kconfig.shield"
osource "C:/ncs/v1.9.1/nrf/boards/shields/*/Kconfig.shield"
```
